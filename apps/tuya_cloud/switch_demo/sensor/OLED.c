#include "OLED.h"
#include "tkl_i2c.h"
#include "tkl_pinmux.h"
#include "tkl_system.h"
#include <string.h>

#define OLED_CONTROL_CMD   0x00
#define OLED_CONTROL_DATA  0x40

static uint8_t g_oled_buffer[OLED_WIDTH * OLED_PAGES];
static BOOL_T g_oled_inited = FALSE;

static const uint8_t font6x8[][6] = {
    [0] = {0},
    [' '] = {0x00, 0x00, 0x00, 0x00, 0x00, 0x00},
    ['%'] = {0x62, 0x64, 0x08, 0x13, 0x23, 0x00},
    ['-'] = {0x08, 0x08, 0x08, 0x08, 0x08, 0x00},
    ['.'] = {0x00, 0x00, 0x60, 0x60, 0x00, 0x00},
    ['/'] = {0x20, 0x10, 0x08, 0x04, 0x02, 0x00},
    ['0'] = {0x3E, 0x51, 0x49, 0x45, 0x3E, 0x00},
    ['1'] = {0x00, 0x42, 0x7F, 0x40, 0x00, 0x00},
    ['2'] = {0x42, 0x61, 0x51, 0x49, 0x46, 0x00},
    ['3'] = {0x21, 0x41, 0x45, 0x4B, 0x31, 0x00},
    ['4'] = {0x18, 0x14, 0x12, 0x7F, 0x10, 0x00},
    ['5'] = {0x27, 0x45, 0x45, 0x45, 0x39, 0x00},
    ['6'] = {0x3C, 0x4A, 0x49, 0x49, 0x30, 0x00},
    ['7'] = {0x01, 0x71, 0x09, 0x05, 0x03, 0x00},
    ['8'] = {0x36, 0x49, 0x49, 0x49, 0x36, 0x00},
    ['9'] = {0x06, 0x49, 0x49, 0x29, 0x1E, 0x00},
    [':'] = {0x00, 0x36, 0x36, 0x00, 0x00, 0x00},
    ['='] = {0x14, 0x14, 0x14, 0x14, 0x14, 0x00},
    ['A'] = {0x7E, 0x11, 0x11, 0x11, 0x7E, 0x00},
    ['B'] = {0x7F, 0x49, 0x49, 0x49, 0x36, 0x00},
    ['C'] = {0x3E, 0x41, 0x41, 0x41, 0x22, 0x00},
    ['D'] = {0x7F, 0x41, 0x41, 0x22, 0x1C, 0x00},
    ['E'] = {0x7F, 0x49, 0x49, 0x49, 0x41, 0x00},
    ['F'] = {0x7F, 0x09, 0x09, 0x09, 0x01, 0x00},
    ['G'] = {0x3E, 0x41, 0x49, 0x49, 0x7A, 0x00},
    ['H'] = {0x7F, 0x08, 0x08, 0x08, 0x7F, 0x00},
    ['I'] = {0x00, 0x41, 0x7F, 0x41, 0x00, 0x00},
    ['J'] = {0x20, 0x40, 0x41, 0x3F, 0x01, 0x00},
    ['K'] = {0x7F, 0x08, 0x14, 0x22, 0x41, 0x00},
    ['L'] = {0x7F, 0x40, 0x40, 0x40, 0x40, 0x00},
    ['M'] = {0x7F, 0x02, 0x0C, 0x02, 0x7F, 0x00},
    ['N'] = {0x7F, 0x04, 0x08, 0x10, 0x7F, 0x00},
    ['O'] = {0x3E, 0x41, 0x41, 0x41, 0x3E, 0x00},
    ['P'] = {0x7F, 0x09, 0x09, 0x09, 0x06, 0x00},
    ['Q'] = {0x3E, 0x41, 0x51, 0x21, 0x5E, 0x00},
    ['R'] = {0x7F, 0x09, 0x19, 0x29, 0x46, 0x00},
    ['S'] = {0x46, 0x49, 0x49, 0x49, 0x31, 0x00},
    ['T'] = {0x01, 0x01, 0x7F, 0x01, 0x01, 0x00},
    ['U'] = {0x3F, 0x40, 0x40, 0x40, 0x3F, 0x00},
    ['V'] = {0x1F, 0x20, 0x40, 0x20, 0x1F, 0x00},
    ['W'] = {0x3F, 0x40, 0x38, 0x40, 0x3F, 0x00},
    ['X'] = {0x63, 0x14, 0x08, 0x14, 0x63, 0x00},
    ['Y'] = {0x07, 0x08, 0x70, 0x08, 0x07, 0x00},
    ['Z'] = {0x61, 0x51, 0x49, 0x45, 0x43, 0x00},
    ['a'] = {0x20, 0x54, 0x54, 0x54, 0x78, 0x00},
    ['c'] = {0x38, 0x44, 0x44, 0x44, 0x20, 0x00},
    ['d'] = {0x38, 0x44, 0x44, 0x48, 0x7F, 0x00},
    ['e'] = {0x38, 0x54, 0x54, 0x54, 0x18, 0x00},
    ['g'] = {0x0C, 0x52, 0x52, 0x52, 0x3E, 0x00},
    ['h'] = {0x7F, 0x08, 0x04, 0x04, 0x78, 0x00},
    ['i'] = {0x00, 0x44, 0x7D, 0x40, 0x00, 0x00},
    ['l'] = {0x00, 0x41, 0x7F, 0x40, 0x00, 0x00},
    ['m'] = {0x7C, 0x04, 0x18, 0x04, 0x78, 0x00},
    ['n'] = {0x7C, 0x08, 0x04, 0x04, 0x78, 0x00},
    ['o'] = {0x38, 0x44, 0x44, 0x44, 0x38, 0x00},
    ['p'] = {0x7C, 0x14, 0x14, 0x14, 0x08, 0x00},
    ['r'] = {0x7C, 0x08, 0x04, 0x04, 0x08, 0x00},
    ['s'] = {0x48, 0x54, 0x54, 0x54, 0x20, 0x00},
    ['t'] = {0x04, 0x3F, 0x44, 0x40, 0x20, 0x00},
    ['u'] = {0x3C, 0x40, 0x40, 0x20, 0x7C, 0x00},
    ['v'] = {0x1C, 0x20, 0x40, 0x20, 0x1C, 0x00},
    ['x'] = {0x44, 0x28, 0x10, 0x28, 0x44, 0x00},
    ['y'] = {0x0C, 0x50, 0x50, 0x50, 0x3C, 0x00}
};

static OPERATE_RET oled_write(uint8_t control, const uint8_t *data, uint32_t len)
{
    uint8_t tx[17] = {0};
    uint32_t offset = 0;
    OPERATE_RET ret = OPRT_OK;

    while (offset < len) {
        uint32_t chunk = len - offset;
        if (chunk > 16) {
            chunk = 16;
        }

        tx[0] = control;
        memcpy(&tx[1], &data[offset], chunk);
        ret = tkl_i2c_master_send(OLED_I2C_PORT, OLED_I2C_ADDR, tx, chunk + 1, FALSE);
        if (ret != OPRT_OK) {
            return ret;
        }
        offset += chunk;
    }

    return ret;
}

static OPERATE_RET oled_write_cmd(uint8_t cmd)
{
    return oled_write(OLED_CONTROL_CMD, &cmd, 1);
}

static OPERATE_RET oled_set_pos(uint8_t page, uint8_t column)
{
    OPERATE_RET ret = oled_write_cmd((uint8_t)(0xB0 + page));
    if (ret != OPRT_OK) {
        return ret;
    }

    ret = oled_write_cmd((uint8_t)(0x00 + (column & 0x0F)));
    if (ret != OPRT_OK) {
        return ret;
    }

    return oled_write_cmd((uint8_t)(0x10 + ((column >> 4) & 0x0F)));
}

static const uint8_t *oled_get_char_bitmap(char ch)
{
    if ((unsigned char)ch >= sizeof(font6x8) / sizeof(font6x8[0])) {
        return font6x8[0];
    }

    if (font6x8[(unsigned char)ch][0] == 0 && ch != ' ') {
        return font6x8[0];
    }

    return font6x8[(unsigned char)ch];
}

OPERATE_RET OLED_Clear(void)
{
    memset(g_oled_buffer, 0, sizeof(g_oled_buffer));

    for (uint8_t page = 0; page < OLED_PAGES; page++) {
        OPERATE_RET ret = oled_set_pos(page, 0);
        if (ret != OPRT_OK) {
            return ret;
        }

        ret = oled_write(OLED_CONTROL_DATA, &g_oled_buffer[page * OLED_WIDTH], OLED_WIDTH);
        if (ret != OPRT_OK) {
            return ret;
        }
    }

    return OPRT_OK;
}

OPERATE_RET OLED_ShowString(uint8_t page, uint8_t column, const char *str)
{
    if (!g_oled_inited || str == NULL || page >= OLED_PAGES || column >= OLED_WIDTH) {
        return OPRT_INVALID_PARM;
    }

    while (*str != '\0' && (column + 6) <= OLED_WIDTH) {
        const uint8_t *bitmap = oled_get_char_bitmap(*str++);
        memcpy(&g_oled_buffer[page * OLED_WIDTH + column], bitmap, 6);
        column += 6;
    }

    OPERATE_RET ret = oled_set_pos(page, 0);
    if (ret != OPRT_OK) {
        return ret;
    }

    return oled_write(OLED_CONTROL_DATA, &g_oled_buffer[page * OLED_WIDTH], OLED_WIDTH);
}

OPERATE_RET OLED_Init(void)
{
    static const uint8_t init_cmds[] = {
        0xAE, 0xD5, 0x80, 0xA8, 0x3F, 0xD3, 0x00, 0x40,
        0x8D, 0x14, 0x20, 0x00, 0xA1, 0xC8, 0xDA, 0x12,
        0x81, 0xCF, 0xD9, 0xF1, 0xDB, 0x40, 0xA4, 0xA6,
        0x2E, 0xAF
    };
    TUYA_IIC_BASE_CFG_T i2c_cfg = {
        .role = TUYA_IIC_MODE_MASTER,
        .speed = TUYA_IIC_BUS_SPEED_100K,
        .addr_width = TUYA_IIC_ADDRESS_7BIT,
    };

    tkl_io_pinmux_config(OLED_SCL_PIN, TUYA_IIC0_SCL);
    tkl_io_pinmux_config(OLED_SDA_PIN, TUYA_IIC0_SDA);
    tkl_i2c_init(OLED_I2C_PORT, &i2c_cfg);

    for (uint32_t i = 0; i < sizeof(init_cmds); i++) {
        OPERATE_RET ret = oled_write_cmd(init_cmds[i]);
        if (ret != OPRT_OK) {
            return ret;
        }
    }

    tkl_system_sleep(50);
    g_oled_inited = TRUE;
    return OLED_Clear();
}
