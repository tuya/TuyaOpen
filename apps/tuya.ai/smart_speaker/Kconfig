## apps/tuya.ai/smart_speaker/Kconfig
```kconfig
menu "configure app (smart_speaker)"

config TUYA_PRODUCT_ID
    string "product ID of project"
    default "dqvmpbcptlgw8hcm"

config SPEAKER_DP_VOLUME
    int "Volume DP ID"
    default 203
    range 1 255

config SPEAKER_DP_MIC
    int "Microphone switch DP ID"
    default 204
    range 1 255

config SPEAKER_DP_PLAY_SWITCH
    int "Play switch DP ID"
    default 205
    range 1 255

config SPEAKER_DP_CTRL_GROUP
    int "Control group DP ID (DND/CTalk/Tmode)"
    default 208
    range 1 255

config SPEAKER_DP_RING
    int "Ringtone trigger DP ID"
    default 207
    range 1 255

config SPEAKER_DP_QUIT
    int "Quit dialog DP ID"
    default 4
    range 1 255

config SPEAKER_DP_BT
    int "BT enable DP ID"
    default 206
    range 1 255

config SPEAKER_DP_BT_SWITCH
    int "BT switch DP ID"
    default 5
    range 1 255

config SPEAKER_DP_BT_VISIBLE
    int "BT discoverable DP ID"
    default 6
    range 1 255

config SPEAKER_DEFAULT_VOLUME
    int "Default volume (0-100)"
    default 70
    range 0 100

config SPEAKER_VOLUME_PROMPT
    bool "Play short WAV on volume change"
    default y if PLATFORM_LINUX
    default n
    help
      Plays embedded volume-change WAV (volume-change prompt WAV) after DP203/CLI volume set.
      Respects DND and skips when FG (TTS/prompt) is playing.

config SPEAKER_BT_CLASSIC
    bool "Classic Bluetooth music (A2DP scaffold)"
    default n
    help
      Enables DP206/5/6 handlers and speaker_bt_player hooks. Requires full A2DP/Opus port
      (see speaker_bt_player.c) for actual streaming; default is wiring + stubs only.


config SPEAKER_HOST_MANUAL_VAD
    bool "Host: inject VAD START after listen (no hardware VAD)"
    default n
    depends on PLATFORM_LINUX
    help
      x86/Linux host builds have no hardware VAD. When enabled, speaker_hw
      injects VAD START after voice_app_start_dialog() (same as CLI 'r').
      Disable on T5 — use platform AUTO VAD after oneshot is armed.

config SPEAKER_CLOUD_BACKEND_LOOPBACK
    bool "Use loopback cloud backend (local ASR/NLG/TTS, no cloud)"
    default n
    depends on PLATFORM_LINUX
    help
      Register cloud_cap_comm loopback backend instead of production MQTT.
      Use for x86/Linux self-tests (test/*.sh) without cloud credentials.
      Leave disabled for production builds and T5 hardware.

config APP_NEED_AI_COMPONENTS
    bool
    default y
    select ENABLE_AI_COMPONENTS

endmenu
```

## apps/tuya.ai/your_chat_bot/Kconfig
```kconfig
menu "configure app (your_chat_bot) "

config APP_CONFIG
    bool
    default y
    select ENABLE_AI_COMPONENTS

config TUYA_PRODUCT_ID
    string "product ID of project"
    default "p320pepzvmm1ghse"

rsource "src/display2/Kconfig"

config ENABLE_BATTERY
    bool "enable the battery module"
    default n

menuconfig ENABLE_APP_LOWPOWER
    bool "enable idle low-power (AP keep-alive / deep sleep, key-mode only)"
    default n
    select ENABLE_TUYA_PM
    help
      In HOLD / push-to-talk (按键) mode, let the device idle into low power after
      APP_LOWPOWER_IDLE_TIME_S seconds with no conversation. The other chat modes keep
      the mic on and stay at full power. Pulls in the tuya_pm power manager.

if ENABLE_APP_LOWPOWER
    choice
        prompt "idle low-power mode"
        default APP_LOWPOWER_AP_KEEPALIVE
        help
        What the device descends into when idle in key-mode.

    config APP_LOWPOWER_AP_KEEPALIVE
        bool "AP keep-alive (DTIM, stays online, uA)"

    config APP_LOWPOWER_DEEP_SLEEP
        bool "deep sleep (offline, wake by key)"

    endchoice

    config APP_LOWPOWER_IDLE_TIME_S
        int "idle seconds before entering low-power"
        default 30
endif # ENABLE_APP_LOWPOWER

endmenu
```

## apps/tuya.ai/your_desk_buddy/Kconfig
```kconfig
menu "configure app (your_desk_buddy)"

config APP_CONFIG
    bool
    default y
    select ENABLE_LIBLVGL
    select ENABLE_LVGL_TP

config DESK_BUDDY_SD_MOUNT_PATH
    string "SD card mount path"
    default "/sdcard"

endmenu
```

## apps/tuya.ai/your_desk_emoji/Kconfig
```kconfig
menu "configure app (your_desk_emoji) "

config APP_CONFIG
    bool
    default y
    select ENABLE_COMP_AI_DISPLAY
    select ENABLE_AI_CHAT_CUSTOM_UI

config TUYA_PRODUCT_ID
    string "product ID of project"
    default "roxam5enkouvqubk"

config APP_NEED_AI_COMPONENTS
    bool
    default y
    select ENABLE_AI_COMPONENTS

endmenu
```

## apps/tuya.ai/your_serial_chat_bot/Kconfig
```kconfig
menu "configure app (your_serial_chat_bot) "

config TUYA_PRODUCT_ID
    string "product ID of project"
    default "p320pepzvmm1ghse"

config APP_NEED_AI_COMPONENTS
    bool
    default y
    select ENABLE_AI_COMPONENTS

endmenu
```

## apps/tuya_cloud/camera_demo/Kconfig
```kconfig
config CAMERA_DEMO
    bool
    default y
    select ENABLE_TUYA_P2P
    select ENABLE_LOCAL_STORE if PLATFORM_LINUX
    select ENABLE_IPC_RING_BUFFER

config CAMERA_DEMO_P2P_FILE_H264
    bool "P2P preview from embedded demo_video.264 (no live camera)"
    depends on CAMERA_DEMO
    depends on !PLATFORM_LINUX
    default n
    help
      T5AI bring-up only: loop Annex-B demo file for P2P instead of GC2145/DVP.
      Disable TUYA_T5AI_BOARD_CAMERA when using this. Not used on Ubuntu
      (Ubuntu already uses demo_video.264 from the filesystem).

config CAMERA_DEMO_SD_LIVE_RECORD
    bool "Live H264 record to local_store (optional, not used by OS wukong P2P)"
    depends on CAMERA_DEMO
    depends on ENABLE_LOCAL_STORE
    default n
    help
      Optional demo extension: while LIVE preview is on, append encoded H264
      AUs to LOCAL_STORE_ROOT/rec/YYYY-MM-DD/live_<ts>.h264 and update index.txt.
      OS wukong P2P does not do LIVE SD record; leave disabled to align OS.
      On T5AI_BOARD requires SD mounted at /sdcard (default SDIO P2/P3/...).
      Uses tkl_fs APIs like examples/peripherals/sd (not tal_fs / ENABLE_FILE_SYSTEM).

config CAMERA_DEMO_SD_RECORD_MAX_SEC
    int "Max seconds per live recording segment (roll on next I-frame)"
    depends on CAMERA_DEMO_SD_LIVE_RECORD
    default 120
    range 30 3600
    help
      Close and index the current segment after this duration, then open a new
      one on the next I-frame.

config CAMERA_DEMO_PB_SEED
    bool "Boot-time PB seed from a fixed H264 file (bring-up only)"
    depends on CAMERA_DEMO
    depends on ENABLE_LOCAL_STORE
    default y if PLATFORM_LINUX
    default n
    help
      Copy ./demo_video.264 (LINUX) or /sdcard/pb_seed.h264 (embedded) into
      today's index for App playback without real recording.
      Prefer CAMERA_DEMO_SD_LIVE_RECORD for product-like testing.
```

## apps/tuya_cloud/ipc_p2p_demo/Kconfig
```kconfig
menu "configure app (ipc_p2p_demo)"

    config CAMERA_DEMO
        bool
        default y
        select ENABLE_TUYA_P2P
        select ENABLE_IPC_RING_BUFFER

    config CAMERA_DEMO_AUDIO
        bool "Two-way audio (mic uplink + speaker intercom)"
        depends on CAMERA_DEMO
        default n
        help
          Capture the mic as G.711 mu-law for the App and play what the App
          sends back. Off while the path is being reworked; with it off the
          App is told this device carries video only.
          Embedded boards only for now - the Linux side has no capture wired up.

    config CAMERA_DEMO_LOCAL_STORE
        bool "Recording and calendar playback"
        depends on CAMERA_DEMO
        default n
        select ENABLE_LOCAL_STORE
        help
          Pulls in the local_store library and the demo's playback handlers.
          With it off, nothing is written and the App's calendar stays empty,
          which also means an embedded board never mounts its SD card.

    config CAMERA_DEMO_WIDTH
        int "Capture width, pixels"
        depends on CAMERA_DEMO

    config CAMERA_DEMO_HEIGHT
        int "Capture height, pixels"
        depends on CAMERA_DEMO

    config CAMERA_DEMO_FPS
        int "Frame rate the encoder is configured for"
        depends on CAMERA_DEMO

    config CAMERA_DEMO_KBPS
        int "Encoder target bitrate, kbps"
        depends on CAMERA_DEMO

    config CAMERA_DEMO_GOP
        int "Frames between I-frames"
        depends on CAMERA_DEMO && !PLATFORM_T5

    config CAMERA_DEMO_P2P_FILE_H264
        bool "P2P preview from embedded demo_video.264 (no live camera)"
        depends on CAMERA_DEMO
        depends on !PLATFORM_LINUX
        default n
        help
          T5AI bring-up only: loop Annex-B demo file for P2P instead of GC2145/DVP.
          Disable TUYA_T5AI_BOARD_CAMERA when using this. Not used on Ubuntu
          (Ubuntu already uses demo_video.264 from the filesystem).

    config CAMERA_DEMO_SD_LIVE_RECORD
        bool "Live H264 record to local_store (optional, not used by OS wukong P2P)"
        depends on CAMERA_DEMO_LOCAL_STORE
        default n
        help
          Optional demo extension: while LIVE preview is on, append encoded H264
          AUs to LOCAL_STORE_ROOT/rec/YYYY-MM-DD/live_<ts>.h264 and update index.txt.
          OS wukong P2P does not do LIVE SD record; leave disabled to align OS.
          On T5AI_BOARD requires SD mounted at /sdcard (default SDIO P2/P3/...).
          Uses tkl_fs APIs like examples/peripherals/sd (not tal_fs / ENABLE_FILE_SYSTEM).

    config CAMERA_DEMO_SD_RECORD_MAX_SEC
        int "Max seconds per live recording segment (roll on next I-frame)"
        depends on CAMERA_DEMO_SD_LIVE_RECORD
        default 120
        range 30 3600
        help
          Close and index the current segment after this duration, then open a new
          one on the next I-frame.

    config CAMERA_DEMO_PB_SEED
        bool "Boot-time PB seed from a fixed H264 file (bring-up only)"
        depends on CAMERA_DEMO_LOCAL_STORE
        default y if PLATFORM_LINUX
        default n
        help
          Copy ./demo_video.264 (LINUX) or /sdcard/pb_seed.h264 (embedded) into
          today's index for App playback without real recording.
          Prefer CAMERA_DEMO_SD_LIVE_RECORD for product-like testing.

endmenu
```

## boards/ESP32/DNESP32S3/Kconfig
```kconfig
config CHIP_CHOICE
    string
    default "esp32s3"

config BOARD_CHOICE
    string
    default "DNESP32S3"

config BOARD_CONFIG
    bool
    default y
    select ENABLE_EXT_RAM
    select ENABLE_AUDIO
    select ENABLE_DISPLAY
    select PLATFORM_FLASHSIZE_16M
    select ENABLE_AUDIO_CODECS
    select ENABLE_BUTTON
    select ENABLE_BUTTON_2
    select ENABLE_BUTTON_3
    select ENABLE_BUTTON_4
    select ENABLE_LED

choice DNESP32S3_EX_LCD_MODULE
    prompt "choose expansion lcd module for DNESP32S3"
    default DNESP32S3_LCD_NONE

    config DNESP32S3_LCD_MD0240_SPI
        bool "SPI LCD (MD0240 ST7789, 320x240)"
        select ENABLE_DISPLAY

    config DNESP32S3_LCD_MD0430R_RGB
        bool "RGB LCD (ATK-MD0430R-800480, 800x480)"
        select ENABLE_DISPLAY
        select ENABLE_TP

    config DNESP32S3_LCD_NONE
        bool "no expansion lcd module"
endchoice

config ENABLE_DNESP32S3_CAMERA
    bool "enable expansion camera module (OV2640 / OV5640)"
    default n
    select ENABLE_CAMERA

config ENABLE_DNESP32S3_SDCARD
    bool "enable expansion sdcard module"
    default n
```

## boards/ESP32/DNESP32S3_BOX2_WIFI/Kconfig
```kconfig
config CHIP_CHOICE
    string
    default "esp32s3"

config BOARD_CHOICE
    string
    default "DNESP32S3_BOX2_WIFI"

config BOARD_CONFIG
    bool
    default y
    select ENABLE_EXT_RAM
    select ENABLE_AUDIO
    select ENABLE_DISPLAY
    select PLATFORM_FLASHSIZE_16M
    select ENABLE_AUDIO_CODECS
    select ENABLE_BUTTON
    select ENABLE_BUTTON_2
    select ENABLE_BUTTON_3
```

## boards/ESP32/ESP32-C2/Kconfig
```kconfig
config CHIP_CHOICE
    string
    default "esp32c2"

config BOARD_CHOICE
    string
    default "ESP32-C2"

config BOARD_CONFIG
    bool
    default y

config UART_NUM0_TX_PIN
    int "UART_NUM0_TX_PIN"
    range 0 20
    default 20
    ---help---
        esp32-c2 default 20

config UART_NUM0_RX_PIN
    int "UART_NUM0_RX_PIN"
    range 0 20
    default 19
    ---help---
        esp32-c2 default 19
```

## boards/ESP32/ESP32-P4-C6/Kconfig
```kconfig
config CHIP_CHOICE
    string
    default "esp32p4"

config BOARD_CHOICE
    string
    default "ESP32-P4-C6"

config BOARD_CONFIG
    bool
    default y
    select ENABLE_EXT_RAM

config UART_NUM0_TX_PIN
    int "UART_NUM0_TX_PIN"
    range 0 54
    default 37
    ---help---
        ESP32-P4 ROM default U0TXD pin (GPIO37). Keep this consistent with
        the IDF default so ROM bootloader, 2nd-stage bootloader, and the
        application share the same physical UART0 TX line.

config UART_NUM0_RX_PIN
    int "UART_NUM0_RX_PIN"
    range 0 54
    default 38
    ---help---
        ESP32-P4 ROM default U0RXD pin (GPIO38). Keep this consistent with
        the IDF default.
```

## boards/ESP32/ESP32-S31/Kconfig
```kconfig
config CHIP_CHOICE
    string
    default "esp32s31"

config BOARD_CHOICE
    string
    default "ESP32-S31"

config BOARD_CONFIG
    bool
    default y
    select ENABLE_EXT_RAM
    select PLATFORM_FLASHSIZE_16M

config UART_NUM0_TX_PIN
    int "UART_NUM0_TX_PIN"
    default 58
    range 0 61

config UART_NUM0_RX_PIN
    int "UART_NUM0_RX_PIN"
    default 59
    range 0 61
```

## boards/ESP32/ESP32/Kconfig
```kconfig
config CHIP_CHOICE
    string
    default "esp32"

config BOARD_CHOICE
    string
    default "ESP32"

config UART_NUM0_TX_PIN
    int "UART_NUM0_TX_PIN"
    range 0 53
    default 1
    ---help---
        esp32    default 1

config UART_NUM0_RX_PIN
    int "UART_NUM0_RX_PIN"
    range 0 53
    default 3
    ---help---
        esp32    default 3

config BOARD_CONFIG
    bool
    default y
    # select ENABLE_AUDIO
    select ENABLE_ESP_DISPLAY
    # select ENABLE_AUDIO_CODECS
    # select ENABLE_DISPLAY
```

## boards/ESP32/ESP32C2_DEVKITM_1/Kconfig
```kconfig
config CHIP_CHOICE
    string
    default "esp32c2"

config BOARD_CHOICE
    string
    default "ESP32C2_DEVKITM_1"

config UART_NUM0_TX_PIN
    int "UART_NUM0_TX_PIN"
    range 0 20
    default 20
    ---help---
        ESP8684-DevKitM-1 UART0 TXD0 (GPIO20)

config UART_NUM0_RX_PIN
    int "UART_NUM0_RX_PIN"
    range 0 20
    default 19
    ---help---
        ESP8684-DevKitM-1 UART0 RXD0 (GPIO19)

config BOARD_CONFIG
    bool
    default y
    select ENABLE_LED
    select ENABLE_BUTTON
    ---help---
        ESP8684-DevKitM-1: ESP8684-MINI-1 module, 4MB flash, 26MHz crystal
        (chip seed sdkconfig_esp32c2 selects CONFIG_XTAL_FREQ_26 accordingly).
        Onboard peripherals: BOOT button on GPIO9, addressable RGB LED on
        GPIO8. GPIO11-17 are SPI flash pins.
```

## boards/ESP32/ESP32S31_KORVO_1/Kconfig
```kconfig
config CHIP_CHOICE
    string
    default "esp32s31"

config BOARD_CHOICE
    string
    default "ESP32S31_KORVO_1"

config BOARD_CONFIG
    bool
    default y
    select ENABLE_EXT_RAM
    select ENABLE_AUDIO_AEC
    select ENABLE_AUDIO_CODECS
    select ENABLE_CAMERA
    select ENABLE_DISPLAY
    select ENABLE_TP
    select ENABLE_BUTTON
    select ENABLE_BUTTON_2
    select ENABLE_BUTTON_3
    select ENABLE_BUTTON_4
    select ENABLE_LED
    select PLATFORM_FLASHSIZE_16M

# ESP32-S31 KORVO routes U0TXD/U0RXD to GPIO58/GPIO59.
config UART_NUM0_TX_PIN
    int "UART_NUM0_TX_PIN"
    default 58
    range 0 61

config UART_NUM0_RX_PIN
    int "UART_NUM0_RX_PIN"
    default 59
    range 0 61
```
