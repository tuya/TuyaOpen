## boards/ESP32/Kconfig
```kconfig
# Ktuyaconf
config PLATFORM_CHOICE
    string
    default "ESP32"

config PLATFORM_ESP32
    bool
    default y

config ENABLE_PLATFORM_MBEDTLS
    bool
    default y

config OPERATING_SYSTEM
    int
    default 98
    ---help---
        100     /* LINUX */
        98      /* RTOS */
        3       /* Non-OS */

config PLATFORM_FLASHSIZE_4M
    bool
    default n

config PLATFORM_FLASHSIZE_8M
    bool
    default n

config PLATFORM_FLASHSIZE_16M
    bool
    default n

config PLATFORM_FLASHSIZE_32M
    bool
    default n

config ENABLE_ESP32S3_USB_JTAG_ONLY
    bool
    default n

rsource "./TKL_Kconfig"
rsource "./OS_SERVICE_Kconfig"

choice
    prompt "Choice a board"

    config BOARD_CHOICE_ESP32_MODULE
        bool "ESP32"
        if (BOARD_CHOICE_ESP32_MODULE)
            rsource "./ESP32/Kconfig"
        endif

    config BOARD_CHOICE_ESP32_C3
        bool "ESP32-C3"
        if (BOARD_CHOICE_ESP32_C3)
            rsource "./ESP32-C3/Kconfig"
        endif

    config BOARD_CHOICE_ESP32_C6
        bool "ESP32-C6"
        if (BOARD_CHOICE_ESP32_C6)
            rsource "./ESP32-C6/Kconfig"
        endif

    config BOARD_CHOICE_ESP32_S3
        bool "ESP32-S3"
        if (BOARD_CHOICE_ESP32_S3)
            rsource "./ESP32-S3/Kconfig"
        endif

    config BOARD_CHOICE_BREAD_COMPACT_WIFI
        bool "ESP32S3_BREAD_COMPACT_WIFI"
        if (BOARD_CHOICE_BREAD_COMPACT_WIFI)
            rsource "./ESP32S3_BREAD_COMPACT_WIFI/Kconfig"
        endif

    config BOARD_CHOICE_XINGZHI_CUBE_0_96_OLED_WIFI
        bool "XINGZHI_ESP32S3_CUDE_0.96_OLED_WIFI"
        if (BOARD_CHOICE_XINGZHI_CUBE_0_96_OLED_WIFI)
            rsource "./XINGZHI_ESP32S3_CUDE_0.96_OLED_WIFI/Kconfig"
        endif

    config BOARD_CHOICE_WAVESHARE_ESP32_S3_TOUCH_AMOLED_1_8
        bool "WAVESHARE_ESP32S3_Touch_AMOLED_1.8"
        if (BOARD_CHOICE_WAVESHARE_ESP32_S3_TOUCH_AMOLED_1_8)
            rsource "./WAVESHARE_ESP32S3_Touch_AMOLED_1.8/Kconfig"
        endif

    config BOARD_CHOICE_DNESP32S3_BOX
        bool "DNESP32S3_BOX"
        if (BOARD_CHOICE_DNESP32S3_BOX)
            rsource "./DNESP32S3_BOX/Kconfig"
        endif

    config BOARD_CHOICE_DNESP32S3
        bool "DNESP32S3"
        if (BOARD_CHOICE_DNESP32S3)
            rsource "./DNESP32S3/Kconfig"
        endif


    config BOARD_CHOICE_DNESP32S3_BOX2_WIFI
        bool "DNESP32S3_BOX2_WIFI"
        if (BOARD_CHOICE_DNESP32S3_BOX2_WIFI)
            rsource "./DNESP32S3_BOX2_WIFI/Kconfig"
        endif

    config BOARD_CHOICE_M5STACK_STICKS3
        bool "M5STACK_STICKS3"
        if (BOARD_CHOICE_M5STACK_STICKS3)
            rsource "./M5STACK_STICKS3/Kconfig"
        endif

        
    config BOARD_CHOICE_WAVESHARE_ESP32C6_DEV_KIT_N16
        bool "WAVESHARE_ESP32C6_DEV_KIT_N16"
        if (BOARD_CHOICE_WAVESHARE_ESP32C6_DEV_KIT_N16)
            rsource "./WAVESHARE_ESP32C6_DEV_KIT_N16/Kconfig"
        endif

    config BOARD_CHOICE_ESP32_P4_C6
        bool "ESP32-P4-C6"
        if (BOARD_CHOICE_ESP32_P4_C6)
            rsource "./ESP32-P4-C6/Kconfig"
        endif

    config BOARD_CHOICE_WAVESHARE_ESP32P4C6_TOUCH_LCD_4_3
        bool "WAVESHARE_ESP32P4C6_TOUCH_LCD_4.3"
        if (BOARD_CHOICE_WAVESHARE_ESP32P4C6_TOUCH_LCD_4_3)
            rsource "./WAVESHARE_ESP32P4C6_TOUCH_LCD_4.3/Kconfig"
        endif

    config BOARD_CHOICE_SEEED_ESP32S3_XIAO_SENSE
        bool "SEEED_ESP32S3_XIAO_SENSE"
        if (BOARD_CHOICE_SEEED_ESP32S3_XIAO_SENSE)
            rsource "./SEEED_ESP32S3_XIAO_SENSE/Kconfig"
        endif

    config BOARD_CHOICE_XTEINK_X4_PRO
        bool "XTEINK_X4_PRO (ESP32-S3 e-paper reader)"
        if (BOARD_CHOICE_XTEINK_X4_PRO)
            rsource "./XTEINK_X4_PRO/Kconfig"

    config BOARD_CHOICE_XTEINK_X4
        bool "XTEINK_X4 (ESP32-C3 e-paper reader)"
        if (BOARD_CHOICE_XTEINK_X4)
            rsource "./XTEINK_X4/Kconfig"
        endif

# <new-board-add: This line cannot be deleted or modified>

endchoice
```

## boards/ESP32/M5STACK_STICKS3/Kconfig
```kconfig
config CHIP_CHOICE
    string
    default "esp32s3"

config BOARD_CHOICE
    string
    default "M5STACK_STICKS3"

config BOARD_CONFIG
    bool
    default y
    select ENABLE_EXT_RAM
    select ENABLE_DISPLAY
    select PLATFORM_FLASHSIZE_8M
    select ENABLE_AUDIO
    select ENABLE_AUDIO_CODECS
    select ENABLE_POWER
    select ENABLE_BUTTON
    select ENABLE_BUTTON_2
    select ENABLE_IMU
    select ENABLE_IMU_BMI270

config BOARD_M5STACK_STICKS3_EXT_5V_OUTPUT
    bool "Enable EXT_5V output on boot"
    default y
    help
        Enable the Grove/Hat EXT_5V output rail during board initialization for
        hardware bring-up. Disable this when the EXT_5V pin may be externally
        powered.
```

## boards/ESP32/SEEED_ESP32S3_XIAO_SENSE/Kconfig
```kconfig
config CHIP_CHOICE
    string
    default "esp32s3"

config BOARD_CHOICE
    string
    default "SEEED_ESP32S3_XIAO_SENSE"

config BOARD_CONFIG
    bool
    default y
    select ENABLE_EXT_RAM
    select ENABLE_CAMERA
    select ENABLE_AUDIO
    select ENABLE_AUDIO_CODECS
    select ENABLE_LED if !ENABLE_SEEED_XIAO_SDCARD
    select ENABLE_BUTTON
    select PLATFORM_FLASHSIZE_8M

config ENABLE_SEEED_XIAO_MAX98357A
    bool "enable MAX98357A I2S amplifier (external module)"
    default y
    ---help---
        External MAX98357A I2S DAC/amp wired to the XIAO expansion pins:
          BCLK -> GPIO7 (D8)
          LRC  -> GPIO4 (D3)
          DIN  -> GPIO2 (D1)
          VIN  -> 5V (recommended), GND -> GND

        Prefer wiring SD (shutdown) to a free GPIO and leave it LOW until
        I2S clocks are ready; tying SD to 3V3 keeps the amp unmuted from
        power-on and will amplify floating DIN as boot noise.

        NOTE: GPIO7 is also the microSD SPI SCK when the TF card option is
        enabled, so the SD card and this amplifier are mutually exclusive.

config ENABLE_SEEED_XIAO_SDCARD
    bool "enable microSD/TF card (Sense expansion board)"
    default n
    depends on !ENABLE_SEEED_XIAO_MAX98357A
    ---help---
        Mux the microSD SPI pins on the Sense expansion board
        (SCK=IO7, MISO=IO8, MOSI=IO9, CS=IO21).

        NOTE: the card's chip-select shares GPIO21 with the onboard user LED,
        so the two are mutually exclusive. This option therefore drives the
        LED: when SD is disabled ENABLE_LED is selected (LED on GPIO21); when
        SD is enabled ENABLE_LED is left off and GPIO21 becomes the SD CS.

        Also mutually exclusive with the MAX98357A amp (both use GPIO7).
```

## boards/ESP32/WAVESHARE_ESP32P4C6_TOUCH_LCD_4.3/Kconfig
```kconfig
config CHIP_CHOICE
    string
    default "esp32p4"

config BOARD_CHOICE
    string
    default "WAVESHARE_ESP32P4C6_TOUCH_LCD_4.3"

config BOARD_CONFIG
    bool
    default y
    select PLATFORM_FLASHSIZE_32M
    select ENABLE_EXT_RAM
    select ENABLE_DISPLAY
    select ENABLE_TP
    select ENABLE_AUDIO
    select ENABLE_AUDIO_CODECS
    select ENABLE_BUTTON

config UART_NUM0_TX_PIN
    int "UART_NUM0_TX_PIN"
    range 0 54
    default 37
    ---help---
        ESP32-P4 ROM default U0TXD pin (GPIO37). Keep this consistent with
        the IDF default so ROM bootloader, 2nd-stage bootloader, and the
        application share the same physical UART0 TX line.

config UART_NUM0_RX_PIN
    int "UART_NUM0_RX_PIN"
    range 0 54
    default 38
    ---help---
        ESP32-P4 ROM default U0RXD pin (GPIO38). Keep this consistent with
        the IDF default.
```

## boards/ESP32/XIAOZHI_ESP32S3_MOON_1.28/Kconfig
```kconfig
config CHIP_CHOICE
    string
    default "esp32s3"

config BOARD_CHOICE
    string
    default "XIAOZHI_ESP32S3_MOON_1.28"

config BOARD_CONFIG
    bool
    default y
    select ENABLE_AUDIO
    select ENABLE_ESP_DISPLAY
    select PLATFORM_FLASHSIZE_16M
    select ENABLE_AUDIO_CODECS
```

## boards/ESP32/XTEINK_X4_PRO/Kconfig
```kconfig
config CHIP_CHOICE
    string
    default "esp32s3"

config BOARD_CHOICE
    string
    default "XTEINK_X4_PRO"

config BOARD_CONFIG
    bool
    default y
    select PLATFORM_FLASHSIZE_16M
    select ENABLE_EXT_RAM

config UART_NUM0_TX_PIN
    int "UART_NUM0_TX_PIN"
    range 0 48
    default 43
    ---help---
        Xteink X4 Pro console UART0. GPIO43/GPIO44 are the S3 UART0 boot pins
        and are not used by the panel, touch, frontlight, buttons or SD slot.

config UART_NUM0_RX_PIN
    int "UART_NUM0_RX_PIN"
    range 0 48
    default 44
    ---help---
        Paired with UART_NUM0_TX_PIN for UART0.
```

## boards/GD32/GD32_MC_FOC_VWS_VW553/Kconfig
```kconfig
config CHIP_CHOICE
    string
    default "gd32vw553"

config BOARD_CHOICE
    string
    default "GD32_MC_FOC_VWS_VW553"

config BOARD_CONFIG
    bool
    default y
```

## boards/GD32/Kconfig
```kconfig
# Ktuyaconf
config PLATFORM_CHOICE
    string
    default "GD32"

config OPERATING_SYSTEM
    int
    default 98
    ---help---
        100     /* LINUX */
        98      /* RTOS */
        3       /* Non-OS */

rsource "./TKL_Kconfig"
rsource "./OS_SERVICE_Kconfig"

choice
    prompt "Choice a board"

    config BOARD_CHOICE_GD32_MC_FOC_VWS_VW553
        bool "GD32_MC_FOC_VWS_VW553"
        if (BOARD_CHOICE_GD32_MC_FOC_VWS_VW553)
            rsource "./GD32_MC_FOC_VWS_VW553/Kconfig"
        endif

    config BOARD_CHOICE_LCKFB_GD32VM553
        bool "LCKFB_GD32VM553"
        if (BOARD_CHOICE_LCKFB_GD32VM553)
            rsource "./LCKFB_GD32VM553/Kconfig"
        endif

# <new-board-add: This line cannot be deleted or modified>

endchoice
```
