## apps/tuya.ai/ai_components/Kconfig
```kconfig
menu "configure ai components"
    choice
        prompt "choose ai language"
        default ENABLE_AI_LANGUAGE_CHINESE

        config ENABLE_AI_LANGUAGE_CHINESE
            bool "Chinese"

        config ENABLE_AI_LANGUAGE_ENGLISH
            bool "English"
    endchoice

    rsource "ai_mode/Kconfig"
    rsource "ai_audio/Kconfig"
    rsource "ai_mcp/Kconfig"
    rsource "ai_video/Kconfig"
    rsource "ai_ui/Kconfig"
endmenu
```

## apps/tuya.ai/ai_components/ai_audio/Kconfig
```kconfig
menuconfig ENABLE_COMP_AI_AUDIO
    select ENABLE_AI_PLAYER
    bool "enable ai audio input/output"
    default y

if (ENABLE_COMP_AI_AUDIO)
    choice
        prompt "select ai audio input codec"
        default ENABLE_COMP_AI_AUDIO_CODEC_PCM

    config ENABLE_COMP_AI_AUDIO_CODEC_PCM
        bool "enable ai audio pcm codec"

    config ENABLE_COMP_AI_AUDIO_CODEC_OPUS
        bool "enable ai audio opus codec"

    config ENABLE_COMP_AI_AUDIO_CODEC_SPEEX
        bool "enable ai audio speex codec"

    endchoice

    choice 
        prompt "select player alert source"
        default AI_PLAYER_ALERT_SOURCE_LOCAL

    config AI_PLAYER_ALERT_SOURCE_LOCAL
        bool "use local alert source"

    config AI_PLAYER_ALERT_SOURCE_CLOUD
        bool "use cloud alert source"

    config AI_PLAYER_ALERT_SOURCE_CUSTOM
        bool "use custom alert source"

    endchoice

endif
```

## apps/tuya.ai/ai_components/ai_ui/Kconfig
```kconfig
menuconfig ENABLE_COMP_AI_DISPLAY
    bool "enable ai chat display ui"
    default y

if(ENABLE_COMP_AI_DISPLAY)

config ENABLE_AI_CHAT_CUSTOM_UI
    bool "enable ai chat custom ui"
    default n

if(!ENABLE_AI_CHAT_CUSTOM_UI)
    choice
        prompt "choose present ia chat ui"
        default ENABLE_AI_CHAT_GUI_WECHAT

        config ENABLE_AI_CHAT_GUI_WECHAT
            select ENABLE_LIBLVGL
            bool "Use WeChat-like ui"

        config ENABLE_AI_CHAT_GUI_CHATBOT
            select ENABLE_LIBLVGL
            bool "Use Chatbot ui"

        config ENABLE_AI_CHAT_GUI_OLED
            select ENABLE_LIBLVGL
            bool "Use OLED ui"
    endchoice

    config ENABLE_CIRCLE_UI_STYLE
        depends on ENABLE_AI_CHAT_GUI_CHATBOT
        bool "Enable circle ui style"
        default n

    if(ENABLE_AI_CHAT_GUI_OLED)
        choice AI_CHAT_GUI_OLED_SIZE
            prompt "choose oled ui size"
            default AI_CHAT_GUI_OLED_SIZE_128_64

            config AI_CHAT_GUI_OLED_SIZE_128_64
                bool "OLED size 128x64" 

            config AI_CHAT_GUI_OLED_SIZE_128_32
                bool "OLED size 128x32"
        endchoice
    endif
endif

config ENABLE_AI_UI_TEXT_STREAMING
    bool "enable ui ai msg text streaming display"
    default n

menuconfig ENABLE_AI_UI_ICON_FONT
    bool "enable ai ui icon font"
    default y

if(ENABLE_AI_UI_ICON_FONT)
    choice 
        prompt "choose text font size"
        default FONT_TEXT_SIZE_14_1 if(ENABLE_AI_CHAT_GUI_OLED)
        default FONT_TEXT_SIZE_18_2 if(!ENABLE_AI_CHAT_GUI_OLED)

        config FONT_TEXT_SIZE_14_1
            bool "Text font size 14"

        config FONT_TEXT_SIZE_18_2
            bool "Text font size 18"

        config FONT_TEXT_SIZE_20_4
            bool "Text font size 20"

        config FONT_TEXT_SIZE_30_4
            bool "Text font size 30"
    endchoice

    choice 
        prompt "choose icon font size"
        default FONT_ICON_SIZE_14_1 if(ENABLE_AI_CHAT_GUI_OLED)
        default FONT_ICON_SIZE_16_4 if(!ENABLE_AI_CHAT_GUI_OLED)

        config FONT_ICON_SIZE_14_1
            bool "Icon font size 14"

        config FONT_ICON_SIZE_16_4
            bool "Icon font size 16"

        config FONT_ICON_SIZE_20_4
            bool "Icon font size 20"

        config FONT_ICON_SIZE_30_4
            bool "Icon font size 30"
    endchoice

    choice 
        prompt "choose emo font type"
        default FONT_EMOJI_SIZE_32 if(ENABLE_AI_CHAT_GUI_WECHAT)
        default FONT_EMOJI_SIZE_64 if(ENABLE_AI_CHAT_GUI_CHATBOT)
        default FONT_EMO_AWESOME   if(ENABLE_AI_CHAT_GUI_OLED)

        config FONT_EMOJI_SIZE_32
            bool "Emoji font size 32"

        config FONT_EMOJI_SIZE_64
            bool "Emoji font size 64"

        config FONT_EMO_AWESOME
            bool "Emoji font awesome"
    endchoice

endif

endif
```

## apps/tuya.ai/duo_eye_mood/Kconfig
```kconfig
menu "configure app (duo_eye_mood) "

config APP_CONFIG
    bool
    default y
    select ENABLE_COMP_AI_DISPLAY
    select ENABLE_AI_CHAT_CUSTOM_UI

config TUYA_PRODUCT_ID
    string "product ID of project"
    default "8ixyalzpn0jrun9y"

rsource "../ai_components/Kconfig"

endmenu
```

## apps/tuya.ai/your_chat_bot/src/display/Kconfig
```kconfig
if(ENABLE_CHAT_DISPLAY) 
choice 
    prompt "choose display gui"
    default ENABLE_GUI_WECHAT

    config ENABLE_GUI_WECHAT
        bool "WeChat-like chat interface"

    config ENABLE_GUI_CHATBOT
        bool "Chatbot interface"
endchoice

endif
```

## apps/tuya.ai/your_chat_bot/src/display2/Kconfig
```kconfig
if(ENABLE_CHAT_DISPLAY2) 
choice
    prompt "Select Display UI Style"
    default ENABLE_GUI2_WECHAT
    help
      Choose the user interface style for the chat display.
      Different styles provide different user experiences.

    config ENABLE_GUI2_WECHAT
        bool "WeChat-Style UI"
        help
          Modern chat interface similar to WeChat messenger.
          Features: message bubbles, conversation view.

    config ENABLE_GUI2_CHATBOT
        bool "Chatbot-Style UI"
        help
          Classic chatbot interface
          Features: single conversation thread, simple interaction.
endchoice
endif
```

## apps/tuya.ai/your_chat_bot_hexapod/Kconfig
```kconfig
menu "configure app (your_chat_bot) "

config TUYA_PRODUCT_ID
    string "product ID of project"
    default "p320pepzvmm1ghse"

choice 
    prompt "choose chat mode"
    default ENABLE_CHAT_MODE_ASR_WAKEUP_FREE

    config ENABLE_CHAT_MODE_KEY_PRESS_HOLD_SINGEL
    bool "press and hold button to start a single conversation."   

    config ENABLE_CHAT_MODE_KEY_TRIG_VAD_FREE
    bool "press the button once to start or stop the free conversation."

    config ENABLE_CHAT_MODE_ASR_WAKEUP_SINGEL
    bool "say the wake-up word to initiate a single conversation, similar to a smart speaker."  

    config ENABLE_CHAT_MODE_ASR_WAKEUP_FREE
    bool "saying the wake-up word, you can have a free conversation."  
endchoice

if(ENABLE_CHAT_MODE_ASR_WAKEUP_SINGEL || ENABLE_CHAT_MODE_ASR_WAKEUP_FREE)
    choice    
        prompt "choose wakeup keyword"
        default ENABLE_WAKEUP_KEYWORD_NIHAO_TUYA

        config ENABLE_WAKEUP_KEYWORD_NIHAO_TUYA
        bool "the wake-up word is configured as NI HAO TUYA."   
    
        config ENABLE_WAKEUP_KEYWORD_NIHAO_XIAOZHI
        bool "the wake-up word is configured as NI HAO XIAO ZHI."   

        config ENABLE_WAKEUP_KEYWORD_XIAOZHI_TONGXUE
        bool "the wake-up word is configured as XIAO ZHI TONG XUE."  
    
        config ENABLE_WAKEUP_KEYWORD_XIAOZHI_GUANJIA
        bool "the wake-up word is configured as XIAO ZHI GUAN JIA."  
    endchoice
endif

config ENABLE_CHAT_DISPLAY
    bool "enable the display module"
    default n

    if (ENABLE_CHAT_DISPLAY)
        rsource "./src/display/Kconfig"
    endif

config ENABLE_AUDIO_CHAT
    bool "enable audio chat mode"
    default y
endmenu
```

## apps/tuya.ai/your_chat_bot_hexapod/src/display/Kconfig
```kconfig
if(ENABLE_CHAT_DISPLAY) 
choice
    prompt "choose display gui"
    default ENABLE_GUI_WECHAT

    config ENABLE_GUI_WECHAT
        bool "Use WeChat-like ui"

    config ENABLE_GUI_CHATBOT
        bool "Use Chatbot ui"

    config ENABLE_GUI_OLED
        bool "Use OLED ui"

endchoice

config ENABLE_GUI_STREAM_AI_TEXT
    depends on ENABLE_GUI_WECHAT
    bool "support streaming display of ai text"
    default n

endif
```

## apps/tuya.ai/your_otto_robot/Kconfig
```kconfig
menu "configure app (your_otto_robot) "

config TUYA_PRODUCT_ID
    string "product ID of project"
    default "aub53kai42j8fdlf"

choice
    prompt "choose Otto type"
    default OTTO_TYPE_NINJA_OTTO

    config OTTO_TYPE_NINJA_OTTO
    bool "ninja_otto"

    config OTTO_TYPE_OTTO
    bool "otto"
endchoice

if(OTTO_TYPE_OTTO)
    choice
        prompt "choose Otto product profile"
        default OTTO_PRODUCT_LEGACY

        config OTTO_PRODUCT_LEGACY
        bool "legacy product (6 servos, trim DPs, multi-DP control)"

        config OTTO_PRODUCT_ST7789_V1
        bool "ST7789 V1 product (4 servos, PID 2aay22ssg224cpvi, ptz_control DP5)"
    endchoice

    config OTTO_NO_ARMS
        bool "Otto robot without arm servos"
        default y if OTTO_PRODUCT_ST7789_V1
        default n

    config OTTO_NO_SERVO_TRIM
        bool "disable servo trim calibration DPs and KV"
        default y if OTTO_PRODUCT_ST7789_V1
        default n

    choice
        prompt "choose Otto board type"
        default OTTO_BOARD_DEFAULT_TXP

        config OTTO_BOARD_DEFAULT_TXP
        bool "board default txp Otto robot servo pin define"

        config OTTO_BOARD_DREAM
        bool "board dream Otto robot servo pin define"
    endchoice
endif

config ENABLE_APP_CUSTOM_EYES_UI
    bool "enable custom eyes ui for otto robot"
    default y
    select ENABLE_COMP_AI_DISPLAY
    select ENABLE_AI_CHAT_CUSTOM_UI

if(ENABLE_APP_CUSTOM_EYES_UI)
    choice
        prompt "choose eyes ui size format"
        default APP_UI_EYES_160_80

        config APP_UI_EYES_160_80
            bool "160x80"
        
        config APP_UI_EYES_160_160
            bool "160x160"

        config APP_UI_EYES_240_240
            bool "240x240"

        config APP_UI_EYES_128_128
            bool "128X128"
    endchoice
endif

rsource "../ai_components/Kconfig"

endmenu
```

## apps/tuya.ai/your_robot_dog/Kconfig
```kconfig
menu "configure app (your_robot_dog) "

config TUYA_PRODUCT_ID
    string "product ID of project"
    default "y0k6ydkxphvv5g7acd"

config ENABLE_BATTERY
    bool "enable the battery module"
    default n

rsource "../ai_components/Kconfig"

config ENABLE_DOG_ACTION
    bool "enable the dog action"
    default y

endmenu
```

## apps/tuya.ai/your_robot_dog/src/display/Kconfig
```kconfig
if ENABLE_CHAT_DISPLAY

config ENABLE_GUI_CHATBOT
    bool "Use Robot Dog UI"
    default y

endif
```

## apps/tuya_t5_epaper_reader/Kconfig
```kconfig
menu "Application config"

    config EPAPER_WIFI_SSID
        string "wifi ssid"
        default ""

    config EPAPER_WIFI_PSWD
        string "wifi password"
        default ""

    config EBABLE_SD_PINMUX
        bool "enable sd pinmux"
        default n

if(EBABLE_SD_PINMUX)
    config SD_CLK_PIN
        int "clk pin"
        default 14
        range 0 63

    config SD_CMD_PIN
        int "cmd pin"
        default 15
        range 0 63

    config SD_D0_PIN
            int "cmd pin"
            default 16
            range 0 63

    config SD_D1_PIN
            int "cmd pin"
            default 17
            range 0 63

    config SD_D2_PIN
            int "cmd pin"
            default 18
            range 0 63

    config SD_D3_PIN
            int "cmd pin"
            default 19
            range 0 63

endif

    config BAIDU_NETDISK_ENABLE
        bool "enable baidu netdisk"
        default y

if(BAIDU_NETDISK_ENABLE)
    config BAIDU_NETDISK_APP_KEY
        string "baidu app key (client_id)"
        default ""

    config BAIDU_NETDISK_APP_SECRET
        string "baidu app secret (client_secret)"
        default ""

    config BAIDU_NETDISK_TARGET_DIR
        string "baidu netdisk target dir"
        default "/TuyaT5AI"

    config BAIDU_NETDISK_SCOPE
        string "baidu oauth scope"
        default "basic,netdisk"
endif

endmenu
```

## apps/tuya_t5_pocket/tuya_t5_pocket_ai/Kconfig
```kconfig
menu "configure app (t5 pocket) "

config APP_CONFIG
    bool
    default y
    select ENABLE_COMP_AI_DISPLAY
    select ENABLE_AI_CHAT_CUSTOM_UI
    select ENABLE_LIBLVGL
    select ENABLE_LVGL_LODEPNG
    select LV_FONT_MONTSERRAT_32

config TUYA_PRODUCT_ID
    string "product ID of project"
    default "zcsqsvltoy071a4j"

rsource "../../tuya.ai/ai_components/Kconfig"

endmenu
```

## boards/BK7231X/Kconfig
```kconfig
# Ktuyaconf
config PLATFORM_CHOICE
    string
    default "BK7231X"

config PLATFORM_bk7231x
    bool
    default y

config OPERATING_SYSTEM
    int
    default 98
    ---help---
        100     /* LINUX */
        98      /* RTOS */
        3       /* Non-OS */

rsource "./TKL_Kconfig"
rsource "./OS_SERVICE_Kconfig"

choice
    prompt "Choice a module"

    config MODULE_CHOICE_WB2S
        bool "WB2S"
        if (MODULE_CHOICE_WB2S)
            rsource "./WB2S/Kconfig"
        endif

endchoice
```

## boards/ESP32/ESP32-C3/Kconfig
```kconfig
config CHIP_CHOICE
    string
    default "esp32c3"

config UART_NUM0_TX_PIN
    int "UART_NUM0_TX_PIN"
    range 0 21
    default 21
    ---help---
        esp32-c3 default 21

config UART_NUM0_RX_PIN
    int "UART_NUM0_RX_PIN"
    range 0 21
    default 20
    ---help---
        esp32-c3 default 20
```

## boards/ESP32/ESP32-C6/Kconfig
```kconfig
config CHIP_CHOICE
    string
    default "esp32c6"

config BOARD_CHOICE
    string
    default "ESP32-C6"

config BOARD_CONFIG
    bool
    default y
    select PLATFORM_FLASHSIZE_16M

config UART_NUM0_TX_PIN
    int "UART_NUM0_TX_PIN"
    range 0 44
    default 16
    ---help---
        esp32-c6 default 16

config UART_NUM0_RX_PIN
    int "UART_NUM0_RX_PIN"
    range 0 44
    default 17
    ---help---
        esp32-c6 default 17
```

## boards/ESP32/ESP32-S3/Kconfig
```kconfig
config CHIP_CHOICE
    string
    default "esp32s3"

config BOARD_CHOICE
    string
    default "ESP32-S3"

config UART_NUM0_TX_PIN
    int "UART_NUM0_TX_PIN"
    range 0 44
    default 43
    ---help---
        esp32-s3 default 43

config UART_NUM0_RX_PIN
    int "UART_NUM0_RX_PIN"
    range 0 44
    default 44
    ---help---
        esp32-s3 default 44
```

## boards/ESP32/ESP32S3_BREAD_COMPACT_WIFI/Kconfig
```kconfig
config CHIP_CHOICE
    string
    default "esp32s3"

config BOARD_CHOICE
    string
    default "ESP32S3_BREAD_COMPACT_WIFI"

config BOARD_CONFIG
    bool
    default y
    select ENABLE_AUDIO
    select ENABLE_ESP_DISPLAY
    select PLATFORM_FLASHSIZE_16M
    select ENABLE_AUDIO_CODECS
```

## boards/ESP32/WAVESHARE-ESP32-S3-Touch-AMOLED-1.8/Kconfig
```kconfig
config CHIP_CHOICE
    string
    default "esp32s3"

config BOARD_CHOICE
    string
    default "WAVESHARE-ESP32-S3-Touch-AMOLED-1.8"

config BOARD_CONFIG
    bool
    default y
    select ENABLE_AUDIO
    select ENABLE_DISPLAY
    select PLATFORM_FLASHSIZE_16M
    select ENABLE_AUDIO_CODECS
```

## boards/ESP32/WAVESHARE_ESP32C6_DEV_KIT_N16/Kconfig
```kconfig
config CHIP_CHOICE
    string
    default "esp32c6"

config BOARD_CHOICE
    string
    default "WAVESHARE_ESP32C6_DEV_KIT_N16"

config BOARD_CONFIG
    bool
    default y
    select ENABLE_BUTTON
    select PLATFORM_FLASHSIZE_16M

config UART_NUM0_TX_PIN
    int "UART_NUM0_TX_PIN"
    range 0 44
    default 16
    ---help---
        esp32-c6 default 16

config UART_NUM0_RX_PIN
    int "UART_NUM0_RX_PIN"
    range 0 44
    default 17
    ---help---
        esp32-c6 default 17
```

## boards/ESP32/WAVESHARE_ESP32S3_Touch_AMOLED_1.8/Kconfig
```kconfig
config CHIP_CHOICE
    string
    default "esp32s3"

config BOARD_CHOICE
    string
    default "WAVESHARE_ESP32S3_Touch_AMOLED_1.8"

config BOARD_CONFIG
    bool
    default y
    select ENABLE_EXT_RAM
    select ENABLE_AUDIO
    select ENABLE_BUTTON
    select ENABLE_DISPLAY
    select ENABLE_TP
    select ENABLE_PMIC
    select ENABLE_PMIC_AXP2101
    select PLATFORM_FLASHSIZE_16M
    select ENABLE_AUDIO_CODECS
    select ENABLE_ESP32S3_USB_JTAG_ONLY
```
