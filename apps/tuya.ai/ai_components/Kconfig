## boards/ESP32/Waveshare-ESP32-S3-Touch-AMOLED-1.8/Kconfig
```kconfig
config CHIP_CHOICE
    string
    default "esp32s3"

config BOARD_CHOICE
    string
    default "Waveshare-ESP32-S3-Touch-AMOLED-1.8"

config BOARD_CONFIG
    bool
    default y
    select ENABLE_AUDIO
    select ENABLE_DISPLAY
    select PLATFORM_FLASHSIZE_16M

config AUDIO_DRIVER_NAME
    string "the name of the audio driver"
    default "audio_driver"
```

## boards/ESP32/XINGZHI-CUDE-0.96-OLED-WIFI/Kconfig
```kconfig
config CHIP_CHOICE
    string
    default "esp32s3"

config BOARD_CHOICE
    string
    default "XINGZHI-CUDE-0.96-OLED-WIFI"

config BOARD_CONFIG
    bool
    default y
    select ENABLE_AUDIO
    select ENABLE_DISPLAY
    select PLATFORM_FLASHSIZE_16M
    select ENABLE_AUDIO_CODECS
```

## boards/ESP32/XINGZHI_ESP32S3_CUDE_0.96_OLED_WIFI/Kconfig
```kconfig
config CHIP_CHOICE
    string
    default "esp32s3"

config BOARD_CHOICE
    string
    default "XINGZHI_ESP32S3_CUDE_0.96_OLED_WIFI"

config BOARD_CONFIG
    bool
    default y
    select ENABLE_AUDIO
    select ENABLE_ESP_DISPLAY
    select PLATFORM_FLASHSIZE_16M
    select ENABLE_AUDIO_CODECS
    select ENABLE_ESP32S3_USB_JTAG_ONLY
```
