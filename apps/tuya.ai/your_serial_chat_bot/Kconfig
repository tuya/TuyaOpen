## apps/tuya.ai/your_serial_chat_bot/Kconfig
```kconfig
menu "configure app (your_serial_chat_bot) "

config TUYA_PRODUCT_ID
    string "product ID of project"
    default "p320pepzvmm1ghse"

config APP_NEED_AI_COMPONENTS
    bool
    default y
    select ENABLE_AI_COMPONENTS

config USER_CHAT_UART_NUMBER
    int "Chat UART number"
    range 0 7
    default 0
    help
      TKL UART instance for UTF-8 text chat (115200, 8N1).

endmenu
```

## boards/GD32H77X/GD32H779I_DESK_BUDDY/Kconfig
```kconfig
config CHIP_CHOICE
    string
    default "GD32H779IW"

config BOARD_CHOICE
    string
    default "GD32H779I_DESK_BUDDY"

config BOARD_CONFIG
    bool
    default y
    select ENABLE_AUDIO_CODECS
    select ENABLE_TDD_AUDIO_TY_UART
    select ENABLE_DISPLAY
    select ENABLE_CAMERA
    select ENABLE_CAMERA_2
    select ENABLE_BUTTON
    select ENABLE_TP
    select ENABLE_ENCODER
    select ENABLE_MOTION
    select ENABLE_MOTION_SC7A20
    select ENABLE_LVGL_PARTIAL_FLUSH if (ENABLE_LIBLVGL)
    select ENABLE_LVGL_OS_FREERTOS if (LVGL_VERSION_9)

choice DESK_BUDDY_AUDIO_PLAYBACK_FORMAT
    prompt "Desk Buddy UART playback format"
    default DESK_BUDDY_AUDIO_PLAYBACK_MP3

config DESK_BUDDY_AUDIO_PLAYBACK_PCM
    bool "PCM"
    help
      Register the device playback format as raw PCM. Use this for the generic
      audio playback/record examples.

config DESK_BUDDY_AUDIO_PLAYBACK_MP3
    bool "MP3"
    help
      Register the device playback format as MP3. Use this for the AI cloud
      TTS passthrough path.
endchoice
```

## boards/GD32H77X/GD32H77EI_DESK_BUDDY/Kconfig
```kconfig
config CHIP_CHOICE
    string
    default "GD32H77EIW"

config BOARD_CHOICE
    string
    default "GD32H77EI_DESK_BUDDY"

config BOARD_CONFIG
    bool
    default y
    # Peripheral capability defaults inherited from GD32H779I_DESK_BUDDY.
    # Keep the buildable baseline; verify each capability against the new schematic.
    select ENABLE_AUDIO_CODECS
    select ENABLE_TDD_AUDIO_TY_UART
    select ENABLE_DISPLAY
    select ENABLE_CAMERA
    select ENABLE_CAMERA_2
    select ENABLE_BUTTON
    select ENABLE_TP
    select ENABLE_ENCODER
    select ENABLE_MOTION
    select ENABLE_MOTION_SC7A20
    select ENABLE_LVGL_PARTIAL_FLUSH if (ENABLE_LIBLVGL)
    select ENABLE_LVGL_OS_FREERTOS if (LVGL_VERSION_9)

choice DESK_BUDDY_AUDIO_PLAYBACK_FORMAT
    prompt "Desk Buddy UART playback format"
    default DESK_BUDDY_AUDIO_PLAYBACK_MP3

config DESK_BUDDY_AUDIO_PLAYBACK_PCM
    bool "PCM"
    help
      Register the device playback format as raw PCM. Use this for the generic
      audio playback/record examples.

config DESK_BUDDY_AUDIO_PLAYBACK_MP3
    bool "MP3"
    help
      Register the device playback format as MP3. Use this for the AI cloud
      TTS passthrough path.
endchoice
```

## boards/Kconfig
```kconfig
config BOARD_ENABLE_LINUX
    bool
    default y

config BOARD_ENABLE_T3
    bool
    default y

config BOARD_ENABLE_T5AI
    bool
    default y

config BOARD_ENABLE_ESP32
    bool
    default y

config BOARD_ENABLE_GD32
    bool
    default y

config BOARD_ENABLE_SIWX917
    bool
    default y

config BOARD_ENABLE_T9
    bool
    default y

config BOARD_ENABLE_JIELI
    bool
    default y

# <new-board-enable: This line cannot be deleted or modified>


choice
    prompt "Choice a board"

if (BOARD_ENABLE_LINUX)
    config BOARD_CHOICE_LINUX
        bool "LINUX"
    if (BOARD_CHOICE_LINUX)
    rsource "./LINUX/Kconfig"
    endif
endif

if (BOARD_ENABLE_T3)
    config BOARD_CHOICE_T3
        bool "T3"
    if (BOARD_CHOICE_T3)
    rsource "./T3/Kconfig"
    endif
endif

if (BOARD_ENABLE_T5AI)
    config BOARD_CHOICE_T5AI
        bool "T5AI"
    if (BOARD_CHOICE_T5AI)
    rsource "./T5AI/Kconfig"
    endif
endif

if (BOARD_ENABLE_ESP32)
    config BOARD_CHOICE_ESP32
        bool "ESP32"
    if (BOARD_CHOICE_ESP32)
    rsource "./ESP32/Kconfig"
    endif
endif

if (BOARD_ENABLE_GD32)
    config BOARD_CHOICE_GD32
        bool "GD32"
    if (BOARD_CHOICE_GD32)
    rsource "./GD32/Kconfig"
    endif
endif

if (BOARD_ENABLE_SIWX917)
    config BOARD_CHOICE_SIWX917
        bool "SIWX917"
    if (BOARD_CHOICE_SIWX917)
    rsource "./SIWX917/Kconfig"
    endif
endif

if (BOARD_ENABLE_T9)
    config BOARD_CHOICE_T9
        bool "T9"
    if (BOARD_CHOICE_T9)
    rsource "./T9/Kconfig"
    endif
endif

if (BOARD_ENABLE_JIELI)
    config BOARD_CHOICE_JIELI
        bool "JIELI"
    if (BOARD_CHOICE_JIELI)
    rsource "./JIELI/Kconfig"
    endif
endif

# <new-board-kconfig: This line cannot be deleted or modified>

endchoice
```

## examples/peripherals/camera/output_display/Kconfig
```kconfig
menu "Application config"

    config EXAMPLE_CAMERA_WIDTH
        int "camera width"
        default 480

    config EXAMPLE_CAMERA_HEIGHT
        int "camera height"
        default 480

    config EXAMPLE_CAMERA_FPS
        int "camera fps"
        default 20

    config EXAMPLE_DISPLAY_FRAME_BUFF_NUM
        int "display frame buffers"
        default 2
        help
            Number of full-size framebuffers. Two is enough when a flush hands
            the next buffer to the panel before the producer reuses the old
            one; slow capture paths (a few fps) need a third so the panel is
            never scanning the buffer being converted.

    choice 
        prompt "choose camera output image rotation"
        default EXAMPLE_CAMERA_IMG_ROTATION_0
            
        config EXAMPLE_CAMERA_IMG_ROTATION_0
            bool "camera output image rotation 0"

        config EXAMPLE_CAMERA_IMG_ROTATION_90
            bool "camera output image rotation 90"

        config EXAMPLE_CAMERA_IMG_ROTATION_180
            bool "camera output image rotation 180"

        config EXAMPLE_CAMERA_IMG_ROTATION_270
            bool "camera output image rotation 270"
    endchoice 

endmenu
```

## src/Kconfig
```kconfig
# Ktuyaconf
menu "configure tuyaopen"
    rsource "common/Kconfig"
    rsource "ai_components/Kconfig"
    rsource "audio_player/Kconfig"
    rsource "liblvgl/Kconfig"
    rsource "libu8g2/Kconfig"
    rsource "libjpegturbo/Kconfig"
    rsource "micropython/Kconfig"
    rsource "peripherals/Kconfig"
    rsource "image_album/Kconfig"
    rsource "tuya_service/tal_cli/Kconfig"
    rsource "tuya_service/liblwip/Kconfig"
    rsource "tuya_service/tal_bluetooth/Kconfig"
    rsource "tuya_service/tal_wifi_ulp/Kconfig"
    rsource "tuya_service/tuya_pm/Kconfig"
endmenu
```

## src/peripherals/camera/Kconfig
```kconfig
config ENABLE_CAMERA
    bool "enable camera"
    default n

if (ENABLE_CAMERA)
    config CAMERA_NAME
        string "the name of camera"
        default "camera"

    config ENABLE_UVC
        bool "enable uvc camera"
        depends on PLATFORM_CHOICE = "T5AI"
        default n
endif
```

## src/tuya_service/netmgr/Kconfig
```kconfig
menu "configure netmgr"
    menuconfig ENABLE_WIFI_BACKUP
        bool "ENABLE_WIFI_BACKUP: enable wifi backup network function"
        depends on ENABLE_WIFI
        default n

        help
                Backup network: keep a list of known good APs besides the one in
                use, fall back to them when the current one is lost, and let the
                APP manage that list over the cloud or over BLE. Off by default:
                enable it per board (boards/<platform>/OS_SERVICE_Kconfig) once
                the board has been validated, so the code size is only paid where
                it is used.

        if (ENABLE_WIFI_BACKUP)
            config WIFI_BACKUP_AP_NUM
                int "WIFI_BACKUP_AP_NUM: number of backup APs kept"
                range 1 8
                default 3

                help
                        Maximum number of APs in the backup list, the oldest one
                        is dropped when the list is full.
        endif

    config ENABLE_BT_WIFI_LIST
        bool "ENABLE_BT_WIFI_LIST: enable the WiFi hotspot list query over BLE"
        depends on ENABLE_BLUETOOTH
        default n

        help
                Answers the app's hotspot list request on the BLE transparent
                channel, and advertises the capability in the adv flag and
                combos flag. It runs a blocking all-AP scan, so a board whose
                WiFi driver cannot scan while connected (no APSTA) should turn
                it off.

    if (ENABLE_BT_WIFI_LIST)
        config BT_WIFI_LIST_BUF_SIZE
            int "BT_WIFI_LIST_BUF_SIZE: max JSON buffer size (bytes) for BLE WiFi list"
            range 512 4096
            default 1024

            help
                    Maximum JSON payload size in bytes for the BLE WiFi hotspot list
                    response. Can also be overridden at runtime via
                    ble_wifi_list_buf_size_set().
    endif
endmenu
```

## src/tuya_service/tal_bluetooth/Kconfig
```kconfig
menu "Bluetooth"

config ENABLE_NIMBLE
    bool "ENABLE_NIMBLE: enable the bundled NimBLE host for BLE"
    default n
    help
      Build the bundled NimBLE host and the TKL BLE port from
      src/tuya_service/tal_bluetooth/nimble. Select this on platforms whose
      TKL provides only the HCI transport and rely on this host stack for
      BLE GAP/GATT. Other platforms keep their own BLE stack.

endmenu
```
