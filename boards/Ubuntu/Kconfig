## src/micropython/Kconfig
```kconfig
menuconfig ENABLE_MICROPYTHON
    bool "Enable MicroPython"
    default n
    help
        Enable MicroPython interpreter for T5AI platform

if ENABLE_MICROPYTHON

config MICROPYTHON_HEAP_SIZE
    int "MicroPython heap size (KB)"
    default 64
    range 32 256
    help
        Size of heap memory allocated for MicroPython in kilobytes

config MICROPYTHON_STACK_SIZE
    int "MicroPython stack size (KB)"
    default 8
    range 4 32
    help
        Size of stack memory for MicroPython execution in kilobytes

config MICROPYTHON_ENABLE_REPL
    bool "Enable REPL (Read-Eval-Print Loop)"
    default y
    help
        Enable interactive Python shell via UART

config MICROPYTHON_REPL_UART_NUM
    int "REPL UART number"
    default 0
    range 0 2
    depends on MICROPYTHON_ENABLE_REPL
    help
        UART port number for REPL interface

config MICROPYTHON_REPL_UART_BAUDRATE
    int "REPL UART baudrate"
    default 115200
    depends on MICROPYTHON_ENABLE_REPL
    help
        Baudrate for REPL UART interface

config MICROPYTHON_ENABLE_GC
    bool "Enable garbage collection"
    default y
    help
        Enable automatic garbage collection

config MICROPYTHON_ENABLE_COMPILER
    bool "Enable compiler"
    default y
    help
        Enable runtime Python code compilation

config MICROPYTHON_ENABLE_FROZEN_MODULES
    bool "Enable frozen modules"
    default n
    help
        Enable pre-compiled Python modules in flash

config MICROPYTHON_MODULE_MACHINE
    bool "Enable machine module"
    default y
    help
        Enable hardware control module (GPIO, UART, SPI, I2C, etc.)

config MICROPYTHON_MODULE_NETWORK
    bool "Enable network module"
    default n
    help
        Enable WiFi and network support

config MICROPYTHON_MODULE_TUYA
    bool "Enable Tuya cloud module"
    default n
    help
        Enable Tuya cloud service integration

config MICROPYTHON_DEBUG
    bool "Enable debug output"
    default n
    help
        Enable debug messages from MicroPython core

endif # ENABLE_MICROPYTHON
```

## src/peripherals/Kconfig
```kconfig
menu "configure device driver"
    rsource "button/Kconfig"
    rsource "led/Kconfig"
    rsource "audio_codecs/Kconfig"
    rsource "display/Kconfig"
    rsource "tp/Kconfig"
    rsource "encoder/Kconfig"
    rsource "joystick/Kconfig"
    rsource "pmic/Kconfig"
    rsource "camera/Kconfig"
    rsource "ir/Kconfig"
    rsource "leds_pixel/Kconfig"
    rsource "imu/Kconfig"
endmenu
```

## src/peripherals/audio_codecs/Kconfig
```kconfig
config ENABLE_AUDIO_CODECS
    bool "enable audio codecs"
    default n

if (ENABLE_AUDIO_CODECS)
    config AUDIO_CODECS_NUM
        int "the num of audio codecs"
        range 1 1
        default 1   

    config AUDIO_CODEC_NAME
        string "the name of audio codec"
        default "audio_codec"

    config ENABLE_AUDIO_AEC
        bool "audio support AEC"
        default n

    config ENABLE_AUDIO_ALSA
        bool "enable ALSA audio support"
        default n
        depends on PLATFORM_LINUX
        ---help---
            Enable ALSA (Advanced Linux Sound Architecture) support for audio
            capture and playback on Ubuntu/Linux platforms. This option is only
            available when building for Ubuntu platform.

    if ENABLE_AUDIO_ALSA
        config ALSA_DEVICE_CAPTURE
            string "ALSA capture device name"
            default "default"
            ---help---
                ALSA device name for audio capture (microphone).
                Common values: "default", "hw:0,0", "plughw:0,0"

        config ALSA_DEVICE_PLAYBACK
            string "ALSA playback device name"
            default "default"
            ---help---
                ALSA device name for audio playback (speaker).
                Common values: "default", "hw:0,0", "plughw:0,0"

        config ALSA_BUFFER_FRAMES
            int "ALSA buffer size in frames"
            range 64 8192
            default 1024
            ---help---
                Number of frames in ALSA buffer. Larger values increase
                latency but reduce CPU usage.

        config ALSA_PERIOD_FRAMES
            int "ALSA period size in frames"
            range 32 4096
            default 256
            ---help---
                Number of frames in ALSA period. Should be smaller than
                buffer size.
    endif

endif
```

## src/peripherals/button/Kconfig
```kconfig
config ENABLE_BUTTON
    bool "enable button"
    default n

if (ENABLE_BUTTON) 
    config BUTTION_STACK_SIZE
        int "button task stack size"
        default 2048
        range 1024 16384
        
    config BUTTON_NAME
        string "the name of button 1"
        default "button1"

    config ENABLE_BUTTON_2
        bool "enable button 2"
        default n

    config BUTTON_NAME_2
        string "the name of button 2"
        default "button2"
        depends on ENABLE_BUTTON_2

    config ENABLE_BUTTON_3
        bool "enable button 3"
        default n
        depends on ENABLE_BUTTON_2

    config BUTTON_NAME_3
        string "the name of button 3"
        default "button3"
        depends on ENABLE_BUTTON_3

    config ENABLE_BUTTON_4
        bool "enable button 4"
        default n
        depends on ENABLE_BUTTON_3

    config BUTTON_NAME_4
        string "the name of button 4"
        default "button4"
        depends on ENABLE_BUTTON_4
endif
```

## src/peripherals/display/tft_rgb/Kconfig
```kconfig
if (ENABLE_DISPLAY_DRIVER)
if (ENABLE_DISPLAY_LCD_RGB)
    choice 
        prompt "select tft lcd chip"
        default ENABLE_LCD_RGB_ILI9488

        config ENABLE_LCD_RGB_ILI9488
            bool "ili9488"
    endchoice

    menu "configure tft lcd software spi"
        config LCD_RGB_SW_SPI_RST_PIN
            int "tft lcd spi rst pin"
            range 0 64
            default 53

        config LCD_RGB_SW_SPI_CLK_PIN
            int "tft lcd spi clk pin"
            range 0 64
            default 49

        config LCD_RGB_SW_SPI_CSX_PIN
            int "tft lcd spi cs pin"
            range 0 64
            default 48

        config LCD_RGB_SW_SPI_SDA_PIN
            int "tft lcd spi sda pin"
            range 0 64
            default 50
    endmenu
endif
endif
```
