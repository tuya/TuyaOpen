## boards/Ubuntu/Kconfig
```kconfig
# Ktuyaconf
config PLATFORM_CHOICE
    string
    default "Ubuntu"

config PLATFORM_UBUNTU
    bool
    default y
    select ENABLE_QRCODE

config OPERATING_SYSTEM
    int 
    default 100
    ---help---
        100     /* LINUX */
        98      /* RTOS */
        3       /* Non-OS */

# Audio codec configuration for Ubuntu platform
config AUDIO_CODEC_NAME
    string "Audio codec device name"
    default "alsa_audio"
    ---help---
        Name of the audio codec device. This name is used to identify
        the audio device when calling tdl_audio_find().

config ENABLE_KEYBOARD_INPUT
    bool "Enable keyboard input for Ubuntu"
    default y
    ---help---
        Enable keyboard input handling for Ubuntu platform.
        Allows using keyboard keys to control the application:
        - 'S' key: Start/stop conversation
        - 'V' key: Volume up
        - 'D' key: Volume down
        - 'Q' key: Quit application

config BUTTON_NAME
    string "Button device name"
    default "button"
    ---help---
        Name of the button device (keyboard on Ubuntu).

config LED_NAME
    string "LED device name"  
    default "led"
    ---help---
        Name of the LED device (placeholder for Ubuntu).

rsource "./TKL_Kconfig"
rsource "./OS_SERVICE_Kconfig"
```

## examples/multimedia/audio_recorder/Kconfig
```kconfig
menu "Application config"

config EXAMPLE_AUDIO_SPEAKER_PIN
    int "audio speaker pin"
    default 28
    range 0 63

config EXAMPLE_AUDIO_TRIGGER_PIN
    int "audio trigger pin"
    default 12
    range 0 63
endmenu
```

## examples/multimedia/audio_speaker/Kconfig
```kconfig
menu "Application config"

config EXAMPLE_AUDIO_SPEAKER_PIN
    int "audio speaker pin"
    default 28
    range 0 63

endmenu
```

## examples/peripherals/camera/output_display/Kconfig
```kconfig
menu "Application config"

    config EXAMPLE_CAMERA_WIDTH
        int "camera width"
        default 480

    config EXAMPLE_CAMERA_HEIGHT
        int "camera height"
        default 480

    config EXAMPLE_CAMERA_FPS
        int "camera fps"
        default 20

    choice 
        prompt "choose camera output image rotation"
        default EXAMPLE_CAMERA_IMG_ROTATION_0
            
        config EXAMPLE_CAMERA_IMG_ROTATION_0
            bool "camera output image rotation 0"

        config EXAMPLE_CAMERA_IMG_ROTATION_90
            bool "camera output image rotation 90"

        config EXAMPLE_CAMERA_IMG_ROTATION_180
            bool "camera output image rotation 180"

        config EXAMPLE_CAMERA_IMG_ROTATION_270
            bool "camera output image rotation 270"
    endchoice 

endmenu
```

## examples/peripherals/gpio/Kconfig
```kconfig
menu "Application config"

    config EXAMPLE_OUTPUT_PIN
        int "output pin"
        default 18
        range 0 63

    config EXAMPLE_INPUT_PIN
        int "input pin"
        default 4
        range 0 63

    config EXAMPLE_IRQ_PIN
        int "irq pin"
        default 5
        range 0 63
endmenu
```

## examples/peripherals/i2c/Kconfig
```kconfig
menu "Application config"

    config EXAMPLE_I2C_SCL_PIN
        int "scl pin"
        default 26
        range 0 63

    config EXAMPLE_I2C_SDA_PIN
        int "sda pin"
        default 24
        range 0 63

endmenu
```

## examples/peripherals/ir/Kconfig
```kconfig
menu "Application config"
    config EXAMPLE_IR
        bool
        default y
        select ENABLE_IR

    config EXAMPLE_IR_ENABLE_NEC
        bool "Enable NEC demo"
        default y
        help
          Enable the NEC demo.

    config EXAMPLE_IR_SEND_TIMER
        int "IR send timer"
        default 3
        range 0 3
        help
          Select the timer for IR send driver.

    config EXAMPLE_IR_RECV_TIMER
        int "IR recv timer"
        default 3
        range 0 3
        help
          Select the timer for IR recv driver.
          
    config EXAMPLE_IR_TX_PIN
        int "IR tx pin"
        default 24
        range 0 63
        help
          Select the TX pin for IR driver.

    config EXAMPLE_IR_RX_PIN
        int "IR rx pin"
        default 26
        range 0 63
        help
          Select the RX pin for IR driver.
endmenu
```

## examples/peripherals/leds-pixel/Kconfig
```kconfig
menu "Application config"

    config EXAMPLE_LEDS_PIXEL
        bool
        default y
        select ENABLE_LEDS_PIXEL

endmenu
```

## src/ai_components/ai_mode/Kconfig
```kconfig
menuconfig ENABLE_COMP_AI_PRESENT_MODE
    bool "enable ai present mode"
    select ENABLE_COMP_AI_AUDIO
    default y

if(ENABLE_COMP_AI_PRESENT_MODE)
    config ENABLE_COMP_AI_MODE_HOLD
        bool "enable ai mode hold"
        default y

    config ENABLE_COMP_AI_MODE_ONESHOT
        bool "enable ai mode oneshot"
        default y

    config ENABLE_COMP_AI_MODE_WAKEUP
        bool "enable ai mode wakeup"
        default y

    config ENABLE_COMP_AI_MODE_FREE
        bool "enable ai mode free"
        default y
endif
```

## src/ai_components/ai_picture/Kconfig
```kconfig
menuconfig ENABLE_COMP_AI_PICTURE
    bool "enable ai picture"
    select ENABLE_IMAGE_ALBUM
    default n

if(ENABLE_COMP_AI_PICTURE)
    config COMP_AI_PICTURE_ALBUM_NAME
        string "ai picture album name"
        default "ai_picture"

    config COMP_AI_PICTURE_ALBUM_MAX_IMAGE_CNT
        int "the max count of image in album"
        default 10

    config COMP_AI_PICTURE_DEF_OUTPIUT_WIDTH
        int "ai picture output default width"
        default 320

    config COMP_AI_PICTURE_DEF_OUTPIUT_HEIGHT
        int "ai picture output default height"
        default 480

    menuconfig ENABLE_COMP_AI_PICTURE_HOSTING_DLD
        bool "enable ai picture file storage download"
        select ENABLE_FILE_STORAGE
        default n

    if(ENABLE_COMP_AI_PICTURE_HOSTING_DLD)
        config COMP_AI_PICTURE_DLD_MAX_FILE_SIZE
            int "max file size per downloaded image (bytes)"
            default 512000

        config COMP_AI_PICTURE_DLD_MAX_FILE_CNT
            int "max file count per download batch"
            default 10

        config COMP_AI_PICTURE_DLD_UNIT_SIZE
            int "http download unit size (bytes)"
            default 32768
    endif
endif
```

## src/ai_components/ai_video/Kconfig
```kconfig
menuconfig ENABLE_COMP_AI_VIDEO
    select ENABLE_CAMERA
    bool "enable ai camera"
    default n

if(ENABLE_COMP_AI_VIDEO)
    config COMP_AI_VIDEO_WIDTH
        int "ai video input width"
        default 480

    config COMP_AI_VIDEO_HEIGHT
        int "ai video input height"
        default 480

    config COMP_AI_VIDEO_FPS        
        int "ai video input fps"
        default 20

    config ENABLE_COMP_AI_VIDEO_JPEG_QUALITY        
        bool "enable ai video input jpeg quality"
        default y
    
    config COMP_AI_VIDEO_JPEG_QUALITY_MAX_SIZE
        int "ai video input jpeg quality max size(kb)"
        default 25
        depends on ENABLE_COMP_AI_VIDEO_JPEG_QUALITY    

    config COMP_AI_VIDEO_JPEG_QUALITY_MIN_SIZE
        int "ai video input jpeg quality min size(kb)"
        default 10
        depends on ENABLE_COMP_AI_VIDEO_JPEG_QUALITY    
endif
```

## src/audio_player/Kconfig
```kconfig
menuconfig ENABLE_AI_PLAYER
    select ENABLE_AUDIO_CODECS
    bool "ENABLE_AI_PLAYER: Enable AI player"
    default n

    if (ENABLE_AI_PLAYER)
        config AI_PLAYER_STACK_SIZE
            int "AI_PLAYER_STACK_SIZE: player thread stack size"
            default 5120
        config AI_PLAYER_FRAMEBUF_SIZE
            int "AI_PLAYER_FRAMEBUF_SIZE: player frame buf size"
            default 4096
        config AI_PLAYER_DECODEBUF_SIZE
            int "AI_PLAYER_DECODEBUF_SIZE: player decode buf size"
            default 8192
        config AI_PLAYER_RINGBUF_SIZE
            int "AI_PLAYER_RINGBUF_SIZE: player ring buf size"
            default 16384
        config AI_PLAYER_HTTP_YIELD_MS
            int "AI_PLAYER_HTTP_YIELD_MS: player http yield ms"
            range 1 100
            default 10
        config AI_PLAYER_HTTP_TIMEOUT_S
            int "AI_PLAYER_HTTP_TIMEOUT_S: player http timeout seconds"
            range 60 300
            default 180
        menu "Decoder Options"
            config ENABLE_AI_PLAYER_DECODER_OPUS
                bool "ENABLE_AI_PLAYER_DECODER_OPUS: Enable OPUS decoder without any container"
                default n
            config AI_PLAYER_DECODER_OPUS_FRAME_SIZE
                depends on ENABLE_AI_PLAYER_DECODER_OPUS
                int "AI_PLAYER_DECODER_OPUS_FRAME_SIZE: OPUS decoder frame size in ms"
                default 40
                range 10 60
            config AI_PLAYER_DECODER_OPUS_KBPS
                depends on ENABLE_AI_PLAYER_DECODER_OPUS
                int "AI_PLAYER_DECODER_OPUS_KBPS: OPUS decoder kbps, 16kbps or 24kbps is recommended"
                default 16
                range 16 128
            config ENABLE_AI_PLAYER_DECODER_OGGOPUS
                depends on ENABLE_AI_PLAYER_DECODER_OPUS
                bool "ENABLE_AI_PLAYER_DECODER_OGGOPUS: Enable OGGOPUS decoder without any container"
                default n
        endmenu # Decoder Options
    endif # ENABLE_AI_PLAYER
```

## src/image_album/Kconfig
```kconfig
menuconfig ENABLE_IMAGE_ALBUM
    bool "ENABLE_IMAGE_ALBUM: Enable image album component"
    default n

    if (ENABLE_IMAGE_ALBUM)
        config ENABLE_IMAGE_ALBUM_STORAGE_MEM
            bool "ENABLE_IMAGE_ALBUM_STORAGE_MEM: Enable memory storage backend"
            default y
            help
              Store pictures in RAM for fast access.
              Pictures are lost on power cycle.

        config ENABLE_IMAGE_ALBUM_STORAGE_SD
            bool "ENABLE_IMAGE_ALBUM_STORAGE_SD: Enable filesystem storage backend"
            default n
            help
              Store pictures on filesystem (SD card, flash, etc.)
              for persistent storage across power cycles.
    endif # ENABLE_IMAGE_ALBUM
```

## src/libjpegturbo/Kconfig
```kconfig
config ENABLE_LIBJPEGTURBO
  bool "configure enable/disable libjpegturbo"
	default n
```

## src/liblvgl/simulator/Kconfig
```kconfig
menuconfig LVGL_PC_SIMULATOR
    bool "LVGL PC Simulator (SDL)"
    depends on ENABLE_LIBLVGL && PLATFORM_LINUX
    default n
    help
      Build as PC simulator with SDL2 window.
      Only display/UI code will be compiled.

if LVGL_PC_SIMULATOR

    config SIM_SCREEN_WIDTH
        int "Screen width"
        default 384

    config SIM_SCREEN_HEIGHT
        int "Screen height"
        default 168

    config SIM_WINDOW_TITLE
        string "Window title"
        default "TuyaOpen LVGL Simulator"

    config SIM_ENTRY_FUNC
        string "UI entry function name"
        default "ui_init"
        help
          The function called after LVGL init to create UI.
          Must be provided by the app display code.

endif
```
