## boards/LINUX/Ubuntu/Kconfig
```kconfig
config CHIP_CHOICE
    string
    default "Ubuntu"

config BOARD_CHOICE
    string
    default "Ubuntu"

config BOARD_CONFIG
    bool
    default y
    select ENABLE_QRCODE
    select ENABLE_BUTTON

config ENABLE_KEYBOARD_INPUT
    bool "Enable keyboard input for Ubuntu"
    default y
    ---help---
        Enable keyboard input handling for Ubuntu platform.

config BUTTON_NAME
    string "Keyboard button key character"
    depends on ENABLE_KEYBOARD_INPUT
    default "s"
    ---help---
        Specify the keyboard key character used as the button trigger.

config ENABLE_SDL_DISPLAY
    bool "Enable SDL2 desktop window for display"
    depends on ENABLE_DISPLAY
    default y
    ---help---
        Enable a simple SDL2 window as the display device.

config ENABLE_SDL_TP
    bool "Enable SDL virtual touchpad (mouse drag/wheel)"
    depends on ENABLE_SDL_DISPLAY
    select ENABLE_TP
    select ENABLE_LVGL_TP
    default y
    ---help---
        Enable a virtual touchpad on Ubuntu Desktop.

config SDL_DISPLAY_WIDTH
    int "SDL window width"
    depends on ENABLE_SDL_DISPLAY
    default 480

config SDL_DISPLAY_HEIGHT
    int "SDL window height"
    depends on ENABLE_SDL_DISPLAY
    default 480
```

## boards/RDK_X5/Kconfig
```kconfig
choice
    prompt "选择一个基于 RDK_X5 的版型"

    config BOARD_CHOICE_RDK_X5_ORIGINBOT
        bool "RDK_X5_ORIGINBOT - 用于 OriginBot 的 RDK_X5 版型"  

        if BOARD_CHOICE_RDK_X5_ORIGINBOT

            rsource "./RDK_X5_ORIGINBOT/Kconfig" 
endchoice
```
