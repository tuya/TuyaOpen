## boards/SiWx917/BRD2605A/Kconfig
```kconfig
config CHIP_CHOICE
    string
    default "SIWG917M111MGTBA"

config BOARD_CHOICE
    string
    default "BRD2605A"

config BOARD_NAME
    string
    default "brd2605a"

config BOARD_CONFIG
    bool
    default y
    select ENABLE_BUTTON
    select ENABLE_LED
    select ENABLE_AUDIO
    select ENABLE_AUDIO_CODECS
    select MP3_DECODER_STATIC_BUF

config BOARD_SW1_PIN
    int "BOARD_SW1_PIN"
    default 49

config BOARD_SW1_NAME
    string
    default "SW1"

config BOARD_SW2_PIN
    int "BOARD_SW2_PIN"
    default 2

config BOARD_SW2_NAME
    string
    default "SW2"

config BOARD_SW3_PIN
    int "BOARD_SW3_PIN"
    default 3

config BOARD_SW3_NAME
    string
    default "SW3"

config BOARD_LEDR_PIN
    int "BOARD_LEDR_PIN"
    default 50

config BOARD_LEDR_NAME
    string
    default "LEDR"

config BOARD_LEDG_PIN
    int "BOARD_LEDG_PIN"
    default 51

config BOARD_LEDG_NAME
    string
    default "LEDG"

config BOARD_LEDB_PIN
    int "BOARD_LEDB_PIN"
    default 15

config BOARD_LEDB_NAME
    string
    default "LEDB"
```

## boards/SiWx917/Kconfig
```kconfig
#Ktuyaconf
config PLATFORM_CHOICE
    string
    default "SiWx917"

config OPERATING_SYSTEM
    int 
    default 98
    ---help---
        100     /* LINUX */
        98      /* RTOS */
        3       /* Non-OS */

rsource "./TKL_Kconfig"
rsource "./OS_SERVICE_Kconfig"

choice
    prompt "Choice a board"
 
    config BOARD_CHOICE_SIWX917_AI_DEV_KIT
        bool "SIWX917_AI_DEV_KIT"
        if (BOARD_CHOICE_SIWX917_AI_DEV_KIT)
            rsource "./SIWX917_AI_DEV_KIT/Kconfig"
        endif

    config BOARD_CHOICE_BRD2605A
        bool "BRD2605A"
        if (BOARD_CHOICE_BRD2605A)
            rsource "./BRD2605A/Kconfig"
        endif
endchoice

menu "Peripherals config"
    rsource "./common/Kconfig"
endmenu

choice
    prompt "Core M4 Flash Size (KB)"
    default CORE_M4_FLASH_SIZE_2040
    help
      Select the M4 flash size for the SiWx917 platform.
      
      IMPORTANT: When changing M4 Flash Size, please follow the guide 
      to write new MBR on README to ensure proper flash partitioning.

    config CORE_M4_FLASH_SIZE_2040
        bool "2048 KB"
        help
          Use 2048 KB flash size for M4 core.

    config CORE_M4_FLASH_SIZE_3008
        bool "3008 KB"
        help
          Use 3008 KB flash size for M4 core.
endchoice

config CORE_M4_FLASH_SIZE
    int
    default 2040 if CORE_M4_FLASH_SIZE_2040
    default 3008 if CORE_M4_FLASH_SIZE_3008

config ENABLE_TDD_DISP_ST7789
    bool "Enable ST7789 Display Support"
    default n
    help
      Enable support for ST7789 TFT LCD display controller.
      This enables the TDD (Tuya Display Driver) for ST7789.
```

## boards/T5AI/NICEMCU_T5/Kconfig
```kconfig
config CHIP_CHOICE
    string
    default "T5AI"

config BOARD_CHOICE
    string
    default "NICEMCU_T5"

config BOARD_CONFIG
    bool
    default y
    select ENABLE_AUDIO_CODECS
    select ENABLE_I2S
    select ENABLE_BUTTON
    # No onboard LCD on NiceMCU-T5 breakout
```

## boards/T5AI/TUYA_T5AI_CORE/Kconfig
```kconfig
config CHIP_CHOICE
    string
    default "T5AI"

config BOARD_CHOICE
    string
    default "TUYA_T5AI_CORE"

config BOARD_CONFIG
    bool
    default y
    select ENABLE_AUDIO_CODECS
    select ENABLE_AUDIO_AEC
    select ENABLE_LED
    select ENABLE_BUTTON

config BOARD_T5AI_CORE_SSD2677
    bool "External SSD2677 E0397A09-A0 display on SPI1"
    default n
    select ENABLE_DISPLAY
    help
        Optional external 800x480 panel with 680 controller scan rows.
        CLK=2, SDA=4, CS=3, DC=7, RST=8, BUSY=6; no PWR control pin.
        Reserve the unused MISO GPIO5 and use a dedicated SPI bus.
```

## boards/T9/Kconfig
```kconfig
# Ktuyaconf
config PLATFORM_CHOICE
    string
    default "T9"

config PLATFORM_T9
    bool
    default y

config OPERATING_SYSTEM
    int
    default 98
    ---help---
        100     /* LINUX */
        98      /* RTOS */
        3       /* Non-OS */

rsource "./TKL_Kconfig"

rsource "./OS_SERVICE_Kconfig"

choice
    prompt "Choice a board"
    default BOARD_CHOICE_TUYA_T9_EVB

    config BOARD_CHOICE_TUYA_T9_EVB
        bool "TUYA_T9_EVB"
        if (BOARD_CHOICE_TUYA_T9_EVB)
            rsource "./TUYA_T9_EVB/Kconfig"
        endif

# <new-board-add: This line cannot be deleted or modified>

endchoice
```

## boards/T9/TUYA_T9_EVB/Kconfig
```kconfig
config CHIP_CHOICE
    string
    default "T9"

config BOARD_CHOICE
    string
    default "TUYA_T9_EVB"

config BOARD_CONFIG
    bool
    default y
    select ENABLE_AUDIO_CODECS
    select ENABLE_AUDIO_AEC
    select ENABLE_BUTTON
```

## examples/lowpower/cpu_deep_sleep/Kconfig
```kconfig
menu "Application config"

    config EXAMPLE_WAKEUP_RTC
        bool "arm an RTC alarm as a wakeup source"
        default y

    if EXAMPLE_WAKEUP_RTC
        config EXAMPLE_WAKEUP_RTC_SECONDS
            int "seconds until the RTC alarm fires"
            default 10
            range 1 3600
    endif

    config EXAMPLE_WAKEUP_GPIO
        bool "arm a pin as a wakeup source"
        default y

    if EXAMPLE_WAKEUP_GPIO
        config EXAMPLE_WAKEUP_GPIO_PIN
            int "wakeup pin"
            default 0
            range 0 63
            ---help---
                Deep sleep powers most of the chip down, so only pins with a dedicated
                wakeup path can bring it back. On GD32VW553 those are PA0, PA15, PA7
                and PA12, and they only react to a rising edge.

        config EXAMPLE_WAKEUP_GPIO_EDGE
            int "wakeup edge (0: low, 1: high, 2: rising, 3: falling)"
            default 2
            range 0 3
    endif

endmenu
```

## examples/lowpower/wifi_ps/Kconfig
```kconfig
menu "Application config"

    config EXAMPLE_WIFI_SSID
        string "access point to join"
        default "your-ssid"
        ---help---
            Power save is negotiated with the access point, so the example has to be
            associated before there is anything to turn on.

    config EXAMPLE_WIFI_PASSWORD
        string "access point password"
        default "your-password"

    config EXAMPLE_WIFI_CONNECT_TIMEOUT_S
        int "seconds to wait for an address before giving up"
        default 30
        range 5 300

    config EXAMPLE_WIFI_PS
        bool "enable wifi power save"
        default y
        ---help---
            Turn this off to measure what power save is worth, and note that it does not
            mean "skip the call": platforms commonly switch power save on by themselves the
            moment the interface becomes a station, so the example has to ask for it to be
            off explicitly, or the comparison measures the same thing twice.

    config EXAMPLE_WIFI_PS_DTIM
        depends on EXAMPLE_WIFI_PS
        int "DTIM interval to listen on"
        default 1
        range 1 10
        ---help---
            How many beacon intervals the radio may sleep through between wakeups. The
            access point buffers traffic for a dozing station and delivers it on the DTIM
            beacon, so a larger value means fewer wakeups and lower current, at the cost of
            that much more latency for anything waiting.

            1 wakes on every DTIM the access point sends, which is the lowest latency and
            the highest current. Most access points send one every 1-3 beacons, and a
            beacon is typically 102.4 ms.

endmenu
```

## examples/multimedia/opus_encode/Kconfig
```kconfig
menu "Opus benchmark"

config OPUS_BENCH_COMPLEXITY
    int "Encoder complexity (0-10)"
    range 0 10
    default 0

config OPUS_BENCH_REPEAT
    int "Number of audio repetitions"
    range 1 1000
    default 20

config OPUS_BENCH_ROUNDS
    int "Number of independent benchmark rounds"
    range 1 20
    default 20
    help
        Recreate and warm up the encoder for each round. Report per-round
        timings and a summary including the median frame average.

config OPUS_BENCH_HIGH_RES
    bool "Use T5AI AON RTC and DWT timing"
    depends on PLATFORM_CHOICE = "T5AI"
    default y
    help
        Measure wall time with the AON RTC (about 30 us resolution) and
        collect DWT cycle counts. Includes interrupts and preemption.

config OPUS_BENCH_PROFILE
    bool "Profile fixed-point SILK stages and bitrate-control iterations"
    depends on ENABLE_TUYAOPEN_OPUS && (OPUS_BENCH_HIGH_RES || PLATFORM_CHOICE = "L511G_Y7PM")
    default n
    help
        Adds timing callbacks to a generated build-tree copy of SILK.
        L511G_Y7PM uses millisecond ticks; accumulate many frames to identify
        large hotspots. Sub-millisecond calls may measure as zero.
        Profiling adds overhead; disable it for baseline library comparisons.

config OPUS_BENCH_SWEEP
    bool "Benchmark all complexities from 0 to 10"
    default n

config OPUS_BENCH_DUMP_PACKETS
    bool "Print encoded packet bytes for output comparison"
    default n
    help
        Print packet lengths and hexadecimal bytes outside the timed region.
        Intended for short validation runs; logging can affect cache behavior.

endmenu
```

## examples/peripherals/camera/output_display_roi/Kconfig
```kconfig
menu "Application config"

    config EXAMPLE_CAMERA_WIDTH
        int "camera width"
        range 1 4096
        default 320

    config EXAMPLE_CAMERA_HEIGHT
        int "camera height"
        range 1 4096
        default 240

    config EXAMPLE_CAMERA_FPS
        int "camera fps"
        range 1 60
        default 15

    config EXAMPLE_CAMERA_NAME
        string "camera device name"
        default "camera"

    config EXAMPLE_CAMERA_OUTPUT_X
        int "display ROI x"
        range 0 4095
        default 0

    config EXAMPLE_CAMERA_OUTPUT_Y
        int "display ROI y"
        range 0 4095
        default 0

    config EXAMPLE_CAMERA_OUTPUT_WIDTH
        int "display ROI width"
        range 1 4096
        default 320

    config EXAMPLE_CAMERA_OUTPUT_HEIGHT
        int "display ROI height"
        range 1 4096
        default 240

    config EXAMPLE_CAMERA_BAND_LINES
        int "display band lines"
        range 1 64
        default 24

endmenu
```

## examples/peripherals/camera/output_web/Kconfig
```kconfig
menu "Application config"

    config EXAMPLE_CAMERA_WIDTH
        int "camera width"
        default 640

    config EXAMPLE_CAMERA_HEIGHT
        int "camera height"
        default 480

    config EXAMPLE_CAMERA_FPS
        int "camera fps"
        default 15
endmenu
```

## examples/peripherals/camera/self_test/Kconfig
```kconfig
menu "Application config"

    config SELF_TEST_FRAME_COUNT
        int "frames captured per camera"
        range 1 30
        default 3

    config SELF_TEST_TIMEOUT_MS
        int "capture timeout per camera in milliseconds"
        range 500 30000
        default 3000

    config SELF_TEST_WIDTH
        int "self-test capture width"
        default 320

    config SELF_TEST_HEIGHT
        int "self-test capture height"
        default 240

    config SELF_TEST_FPS
        int "self-test capture fps"
        range 1 30
        default 15

endmenu
```

## examples/peripherals/i2c/bme280/Kconfig
```kconfig
menu "App config BME280 I2C"

    config CONFIG_BME280_I2C_SCL_PIN
        int "scl pin"
        default 9
        range 0 63

    config CONFIG_BME280_I2C_SDA_PIN
        int "sda pin"
        default 8
        range 0 63

    config CONFIG_BME280_I2C_BUS
        int "i2c bus"
        default 1
        range 0 5
        
    config CONFIG_BME280_I2C_ADDR
        hex "i2c addr"
        default 0x76
        range 0x76 0x77
        

endmenu
```

## examples/peripherals/i2c/i2c_scan/Kconfig
```kconfig
menu "Application config"

    config EXAMPLE_I2C_PORT
        int "i2c port"
        default 0
        range 0 3

endmenu
```
