## boards/GD32/LCKFB_GD32VM553/Kconfig
```kconfig
config CHIP_CHOICE
    string
    default "gd32vw553"

config BOARD_CHOICE
    string
    default "LCKFB_GD32VM553"

config BOARD_CONFIG
    bool
    default y
    select ENABLE_LED
    select ENABLE_BUTTON
```

## boards/GD32H77X/GD32H779I_DESK_BUDDY/Kconfig
```kconfig
config CHIP_CHOICE
    string
    default "GD32H779IW"

config BOARD_CHOICE
    string
    default "GD32H779I_DESK_BUDDY"

config BOARD_CONFIG
    bool
    default y
    select ENABLE_DISPLAY
    select ENABLE_CAMERA
    select ENABLE_CAMERA_2
    select ENABLE_TP
    select ENABLE_ENCODER
    select ENABLE_MOTION
    select ENABLE_MOTION_SC7A20
    select ENABLE_LVGL_PARTIAL_FLUSH if (ENABLE_LIBLVGL)
    select ENABLE_LVGL_OS_FREERTOS if (LVGL_VERSION_9)
```

## boards/GD32H77X/GD32H779I_WATCH_EVAL/Kconfig
```kconfig
config CHIP_CHOICE
    string
    default "GD32H779IW"

config BOARD_CHOICE
    string
    default "GD32H779I_WATCH_EVAL"

config BOARD_CONFIG
    bool
    default y
    select ENABLE_DISPLAY
    select ENABLE_CAMERA
    select ENABLE_CAMERA_2
    select ENABLE_TP
    select ENABLE_LVGL_PARTIAL_FLUSH if (ENABLE_LIBLVGL)
    select ENABLE_LVGL_OS_FREERTOS if (LVGL_VERSION_9)
```

## boards/GD32H77X/GD32H779V_START/Kconfig
```kconfig
config CHIP_CHOICE
    string
    default "GD32H779VW"

config BOARD_CHOICE
    string
    default "GD32H779V_START"

config BOARD_CONFIG
    bool
    default y
```

## boards/JIELI/AC7916A/Kconfig
```kconfig
config BOARD_CONFIG
    bool
    default y

config CHIP_WL82
    bool
    default y

config JIELI_UART_LOG_PORT
    int "wl82 UART log port"
    default 0
    range 0 5

config JIELI_UART_LOG_BAUDRATE
    int "wl82 UART log baudrate"
    default 115200
    range 1200 4000000
```

## boards/Kconfig
```kconfig
config BOARD_ENABLE_LINUX
    bool
    default y

config BOARD_ENABLE_T2
    bool
    default y

config BOARD_ENABLE_T3
    bool
    default y

config BOARD_ENABLE_T5AI
    bool
    default y

config BOARD_ENABLE_ESP32
    bool
    default y

config BOARD_ENABLE_LN882H
    bool
    default y

config BOARD_ENABLE_BK7231X
    bool
    default y

config BOARD_ENABLE_GD32
    bool
    default y

config BOARD_ENABLE_SIWX917
    bool
    default y

config BOARD_ENABLE_L511G_Y7PM
    bool
    default y

config BOARD_ENABLE_L511C_Y6E
    bool
    default y

config BOARD_ENABLE_L511C_Y7PM
    bool
    default y

# <new-board-enable: This line cannot be deleted or modified>


choice
    prompt "Choice a board"

if (BOARD_ENABLE_LINUX)
    config BOARD_CHOICE_LINUX
        bool "LINUX"
    if (BOARD_CHOICE_LINUX)
    rsource "./LINUX/Kconfig"
    endif
endif

if (BOARD_ENABLE_T2)
    config BOARD_CHOICE_T2
        bool "T2"
    if (BOARD_CHOICE_T2)
    rsource "./T2/Kconfig"
    endif
endif

if (BOARD_ENABLE_T3)
    config BOARD_CHOICE_T3
        bool "T3"
    if (BOARD_CHOICE_T3)
    rsource "./T3/Kconfig"
    endif
endif

if (BOARD_ENABLE_T5AI)
    config BOARD_CHOICE_T5AI
        bool "T5AI"
    if (BOARD_CHOICE_T5AI)
    rsource "./T5AI/Kconfig"
    endif
endif

if (BOARD_ENABLE_ESP32)
    config BOARD_CHOICE_ESP32
        bool "ESP32"
    if (BOARD_CHOICE_ESP32)
    rsource "./ESP32/Kconfig"
    endif
endif

if (BOARD_ENABLE_LN882H)
    config BOARD_CHOICE_LN882H
        bool "LN882H"
    if (BOARD_CHOICE_LN882H)
    rsource "./LN882H/Kconfig"
    endif
endif

if (BOARD_ENABLE_BK7231X)
    config BOARD_CHOICE_BK7231X
        bool "BK7231X"
    if (BOARD_CHOICE_BK7231X)
    rsource "./BK7231X/Kconfig"
    endif
endif

if (BOARD_ENABLE_GD32)
    config BOARD_CHOICE_GD32
        bool "GD32"
    if (BOARD_CHOICE_GD32)
    rsource "./GD32/Kconfig"
    endif
endif

if (BOARD_ENABLE_SIWX917)
    config BOARD_CHOICE_SIWX917
        bool "SIWX917"
    if (BOARD_CHOICE_SIWX917)
    rsource "./SIWX917/Kconfig"
    endif
endif

if (BOARD_ENABLE_L511G_Y7PM)
    config BOARD_CHOICE_L511G_Y7PM
        bool "L511G_Y7PM"
    if (BOARD_CHOICE_L511G_Y7PM)
    rsource "./L511G_Y7PM/Kconfig"
    endif
endif

if (BOARD_ENABLE_L511C_Y6E)
    config BOARD_CHOICE_L511C_Y6E
        bool "L511C_Y6E"
    if (BOARD_CHOICE_L511C_Y6E)
    rsource "./L511C_Y6E/Kconfig"
    endif
endif

if (BOARD_ENABLE_L511C_Y7PM)
    config BOARD_CHOICE_L511C_Y7PM
        bool "L511C_Y7PM"
    if (BOARD_CHOICE_L511C_Y7PM)
    rsource "./L511C_Y7PM/Kconfig"
    endif
endif

# <new-board-kconfig: This line cannot be deleted or modified>

endchoice
```

## boards/Kendryte_K230/Kconfig
```kconfig
# Ktuyaconf
config PLATFORM_CHOICE
    string
    default "Kendryte_K230"

config OPERATING_SYSTEM
    int
    default 98
    ---help---
        100     /* LINUX */
        98      /* RTOS */
        3       /* Non-OS */

rsource "./TKL_Kconfig"
rsource "./OS_SERVICE_Kconfig"

choice
    prompt "Choice a board"

    config BOARD_CHOICE_LCKFB_K230
        bool "LCKFB_K230"
        if (BOARD_CHOICE_LCKFB_K230)
            rsource "./LCKFB_K230/Kconfig"
        endif

# <new-board-add: This line cannot be deleted or modified>

endchoice
```

## boards/Kendryte_K230/LCKFB_K230/Kconfig
```kconfig
config CHIP_CHOICE
    string
    default "k230"

config BOARD_CHOICE
    string
    default "LCKFB_K230"

config BOARD_CONFIG
    bool
    default y
```

## boards/L511C/Kconfig
```kconfig
# Ktuyaconf
config PLATFORM_CHOICE
    string
    default "L511C"

config PLATFORM_L511C
    bool
    default y

config OPERATING_SYSTEM
    int
    default 98
    ---help---
        100     /* LINUX */
        98      /* RTOS */
        3       /* Non-OS */

rsource "./TKL_Kconfig"
rsource "./OS_SERVICE_Kconfig"

choice
    prompt "Choice a board"

    config BOARD_CHOICE_L511C_Y6E
        bool "L511C_Y6E"
        if (BOARD_CHOICE_L511C_Y6E)
            rsource "./L511C_Y6E/Kconfig"
        endif

# <new-board-add: This line cannot be deleted or modified>

endchoice
```

## boards/L511C_Y6E/Kconfig
```kconfig
# Ktuyaconf
config PLATFORM_CHOICE
    string
    default "L511C_Y6E"

config PLATFORM_L511C_Y6E
    bool
    default y

config OPERATING_SYSTEM
    int
    default 98
    ---help---
        100     /* LINUX */
        98      /* RTOS */
        3       /* Non-OS */

rsource "./TKL_Kconfig"
rsource "./OS_SERVICE_Kconfig"

choice
    prompt "Choice a board"

    config BOARD_CHOICE_L511C_Y6E_BOARD
        bool "L511C_Y6E board"
        if (BOARD_CHOICE_L511C_Y6E_BOARD)
            rsource "./L511C_Y6E/Kconfig"
        endif

# <new-board-add: This line cannot be deleted or modified>

endchoice
```

## boards/L511C_Y6E/L511C_Y6E/Kconfig
```kconfig
config CHIP_CHOICE
    string
    default "L511C_Y6E"

config BOARD_CHOICE
    string
    default "L511C_Y6E"

config BOARD_CONFIG
    bool
    default y
```

## boards/L511C_Y7PM/Kconfig
```kconfig
# Ktuyaconf
config PLATFORM_CHOICE
    string
    default "L511C_Y7PM"

config PLATFORM_L511C_Y7PM
    bool
    default y

config OPERATING_SYSTEM
    int
    default 98
    ---help---
        100     /* LINUX */
        98      /* RTOS */
        3       /* Non-OS */

rsource "./TKL_Kconfig"
rsource "./OS_SERVICE_Kconfig"

choice
    prompt "Choice a board"

    config BOARD_CHOICE_L511C_Y7PM
        bool "L511C_Y7PM board"
        if (BOARD_CHOICE_L511C_Y7PM)
            rsource "./L511C_Y7PM/Kconfig"
        endif

# <new-board-add: This line cannot be deleted or modified>

endchoice
```

## boards/L511C_Y7PM/L511C_Y7PM/Kconfig
```kconfig
config CHIP_CHOICE
    string
    default "L511C_Y7PM"

config BOARD_CHOICE
    string
    default "L511C_Y7PM"

config BOARD_CONFIG
    bool
    default y
```

## boards/L511G/Kconfig
```kconfig
# Ktuyaconf
config PLATFORM_CHOICE
    string
    default "L511G"

config PLATFORM_L511G
    bool
    default y

config OPERATING_SYSTEM
    int
    default 98
    ---help---
        100     /* LINUX */
        98      /* RTOS */
        3       /* Non-OS */

rsource "./TKL_Kconfig"
rsource "./OS_SERVICE_Kconfig"

choice
    prompt "Choice a board"

    config BOARD_CHOICE_L511G_Y7PM
        bool "L511G_Y7PM"
        if (BOARD_CHOICE_L511G_Y7PM)
            rsource "./L511G_Y7PM/Kconfig"
        endif

    config BOARD_CHOICE_L511G_Y7PVM
        bool "L511G_Y7PVM"
        if (BOARD_CHOICE_L511G_Y7PVM)
            rsource "./L511G_Y7PVM/Kconfig"
        endif

# <new-board-add: This line cannot be deleted or modified>

endchoice
```

## boards/L511G/L511G_Y7PM/Kconfig
```kconfig
config CHIP_CHOICE
    string
    default "L511G_Y7PM"

config BOARD_CHOICE
    string
    default "L511G_Y7PM"
```

## boards/L511G/L511G_Y7PVM/Kconfig
```kconfig
config CHIP_CHOICE
    string
    default "L511G_Y7PVM"

config BOARD_CHOICE
    string
    default "L511G_Y7PVM"
```

## boards/LINUX/Linux_x86_64/Kconfig
```kconfig
menu "Linux x86_64 Board Configuration"
    config CHIP_CHOICE
        string
        default "Linux_x86_64"

    config BOARD_CHOICE
        string
        default "Linux_x86_64"

    config BOARD_CONFIG
        bool
        default y
        select ENABLE_QRCODE
        select ENABLE_AUDIO
        select ENABLE_BUTTON

    # Audio codec configuration for Linux x86_64 platform
    config AUDIO_CODEC_NAME
        string "Audio codec device name"
        default "default"
        ---help---
            Name of the audio codec device. On Linux x86_64, "default" routes
            to PulseAudio/WirePlumber via ALSA.

    config ENABLE_KEYBOARD_INPUT
        bool "Enable keyboard input for Linux x86_64"
        default y
        ---help---
            Enable keyboard input handling for Linux x86_64 platform.

    config BUTTON_NAME
        string "Keyboard button device value"
        depends on ENABLE_KEYBOARD_INPUT
        default "s"
        ---help---
            Specify the keyboard button device value for input handling.
endmenu
```

## boards/LINUX/RDK_X5/Kconfig
```kconfig
menu "RDK_X5 Board Configuration"
    config CHIP_CHOICE
        string
        default "X5"

    config BOARD_CHOICE
        string
        default "RDK_X5"

    config BOARD_CONFIG
        bool
        default y
        select ENABLE_QRCODE
endmenu
```

## boards/LINUX/TaishanPi_3/Kconfig
```kconfig
menu "TaishanPi_3 Board Configuration"
    config CHIP_CHOICE
        string
        default "RK3576"

    config BOARD_CHOICE
        string
        default "TaishanPi_3"

    config BOARD_CONFIG
        bool
        default y
        select ENABLE_QRCODE
        select ENABLE_AUDIO
        select ENABLE_BUTTON

    # Audio codec configuration for TaishanPi_3 board
    config AUDIO_CODEC_NAME
        string "Audio codec device name"
        default "alsa_audio"
        ---help---
            Name of the audio codec device. This name is used to identify
            the audio device when calling tdl_audio_find().

    config ENABLE_KEYBOARD_INPUT
        bool "Enable keyboard input"
        default y
        ---help---
            Enable keyboard input handling.

    config BUTTON_NAME
        string "Keyboard button device value"
        depends on ENABLE_KEYBOARD_INPUT
        default "s"
        ---help---
            Specify the keyboard button device value for input handling.

    config ENABLE_CAMERA
        bool "Enable Camera"
        default n

    if (ENABLE_CAMERA)
        config ENABLE_CAMERA_V4L2
            bool "Enable V4L2 USB camera"
            default y

        config CAMERA_V4L2_DEVNODE
            string "V4L2 device node"
            depends on ENABLE_CAMERA_V4L2
            default "/dev/video0"
    endif

    config ENABLE_SDL_DISPLAY
        bool "Enable SDL2 desktop window for display"
        depends on ENABLE_DISPLAY
        default y
        ---help---
            Enable a simple SDL2 window as the display device.

    config ENABLE_SDL_TP
        bool "Enable SDL virtual touchpad (mouse drag/wheel)"
        depends on ENABLE_SDL_DISPLAY
        select ENABLE_TP
        select ENABLE_LVGL_TP
        default y
        ---help---
            Enable a virtual touchpad.
            - Mouse left-button drag: press/move/release as single-touch
            - Mouse wheel: generates a short swipe gesture for vertical scrolling

    config SDL_DISPLAY_WIDTH
        int "SDL window width"
        depends on ENABLE_SDL_DISPLAY
        default 480

    config SDL_DISPLAY_HEIGHT
        int "SDL window height"
        depends on ENABLE_SDL_DISPLAY
        default 480

    config SDL_DISPLAY_TITLE
        string "SDL window title"
        depends on ENABLE_SDL_DISPLAY
        default "TuyaOpen - your_chat_bot"
endmenu
```
