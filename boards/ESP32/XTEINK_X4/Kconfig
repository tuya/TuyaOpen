## boards/T5AI/T5AI_OTTO/Kconfig
```kconfig
config CHIP_CHOICE
    string
    default "T5AI"

config BOARD_CHOICE
    string
    default "T5AI_OTTO"

config BOARD_CONFIG
    bool
    default y
    select ENABLE_AUDIO_CODECS
    select ENABLE_AUDIO_AEC


choice T5AI_OTTO_EX_MODULE
    prompt "choose expansion module for T5AI_OTTO"
    default T5AI_OTTO_EX_MODULE_NONE

    config T5AI_OTTO_EX_MODULE_NONE
        bool "no expansion module"

    config T5AI_OTTO_EX_MODULE_ST7789
        bool "ST7789 240x240 spi LCD"
        select ENABLE_DISPLAY
        select ENABLE_LVGL_V8_RGB565_SWAP if (LVGL_VERSION_8 && LVGL_V8_COLOR_DEPTH_16)
        select ENABLE_LVGL_DUAL_DISP_BUFF if (ENABLE_LIBLVGL)
	    select ENABLE_LVGL_OS_FREERTOS if (LVGL_VERSION_9)

    config T5AI_OTTO_EX_MODULE_ST7735S_XLT
        bool "ST7735S XLT 160x80 spi LCD"
        select ENABLE_DISPLAY
        select ENABLE_LVGL_V8_RGB565_SWAP if (LVGL_VERSION_8 && LVGL_V8_COLOR_DEPTH_16)
	    select ENABLE_LVGL_DUAL_DISP_BUFF if (ENABLE_LIBLVGL)
	    select ENABLE_LVGL_OS_FREERTOS if (LVGL_VERSION_9)

    config T5AI_OTTO_EX_MODULE_GC9D01
        bool "GC9D01 160x160 spi LCD"
        select ENABLE_DISPLAY
        select ENABLE_LVGL_DUAL_DISP_BUFF if (ENABLE_LIBLVGL)
	    select ENABLE_LVGL_OS_FREERTOS if (LVGL_VERSION_9)
endchoice
```

## boards/T5AI/TUYA_T5AI_BOARD/Kconfig
```kconfig
config CHIP_CHOICE
    string
    default "T5AI"

config BOARD_CHOICE
    string
    default "TUYA_T5AI_BOARD"

config BOARD_CONFIG
    bool
    default y
    select ENABLE_AUDIO_CODECS
    select ENABLE_LED
    select ENABLE_BUTTON

choice TUYA_T5AI_BOARD_VERSION
    prompt "choose TUYA_T5AI_BOARD version"
    default TUYA_T5AI_BOARD_VERSION_102
    help
        Select the version of the TUYA T5AI board you are using.

    config TUYA_T5AI_BOARD_VERSION_101
        bool "T5AI_BOARD_V101"

    config TUYA_T5AI_BOARD_VERSION_102
        bool "T5AI_BOARD_V102"
        select ENABLE_AUDIO_AEC
endchoice

# ---- LCD Module (choose one) ----
choice TUYA_T5AI_BOARD_LCD
    prompt "LCD module"
    default TUYA_T5AI_BOARD_LCD_NONE

    config TUYA_T5AI_BOARD_LCD_NONE
        bool "none"

    config TUYA_T5AI_BOARD_LCD_35565
        bool "3.5 inch 480x320 RGB565 (ILI9488 + GT1151 touch)"
        select ENABLE_DISPLAY
        select ENABLE_TP
        select ENABLE_LVGL_OS_FREERTOS if (LVGL_VERSION_9)
        select ENABLE_LVGL_DUAL_DISP_BUFF if (ENABLE_LIBLVGL)

    config TUYA_T5AI_BOARD_LCD_EYES
        bool "1.28 inch 128x128 SPI round LCD x2 (ST7735S eyes)"
        select ENABLE_DISPLAY
        select ENABLE_LVGL_OS_FREERTOS if (LVGL_VERSION_9)
        select ENABLE_LVGL_DUAL_DISP_BUFF if (ENABLE_LIBLVGL)
        select ENABLE_LVGL_V8_RGB565_SWAP if (LVGL_VERSION_8 && LVGL_V8_COLOR_DEPTH_16)

    config TUYA_T5AI_BOARD_LCD_096_OLED
        bool "0.96 inch 128x64 I2C OLED (SSD1306)"
        select ENABLE_DISPLAY
        select ENABLE_LVGL_OS_FREERTOS if (LVGL_VERSION_9)
endchoice

config ENABLE_EYES_TWO_LCD
    bool "dual display (drive both eyes independently)"
    depends on TUYA_T5AI_BOARD_LCD_EYES
    default n
    select ENABLE_DISPLAY_2

# ---- Camera Module ----
config TUYA_T5AI_BOARD_CAMERA
    bool "Camera module (GC2145 DVP)"
    default n
    select ENABLE_CAMERA

# ---- Printer Module ----
config TUYA_T5AI_BOARD_PRINTER_DP48
    bool "DP-48A ESC/POS thermal printer (UART0, 9600 bps)"
    default n
    select ENABLE_PRINTER
    select ENABLE_PRINTER_DP48
```

## boards/T5AI/TUYA_T5AI_DESKTOP_ROBOT/Kconfig
```kconfig
config CHIP_CHOICE
    string
    default "T5AI"

config BOARD_CHOICE
    string
    default "TUYA_T5AI_DESKTOP_ROBOT"

config BOARD_CONFIG
    bool
    default y
    select ENABLE_DISPLAY
    select ENABLE_TP
    select ENABLE_LVGL_DUAL_DISP_BUFF if (ENABLE_LIBLVGL)
    select ENABLE_LVGL_DMA2D if (ENABLE_LIBLVGL)
    select ENABLE_LVGL_OS_FREERTOS if (LVGL_VERSION_9)
```

## boards/T5AI/TUYA_T5AI_DOG/Kconfig
```kconfig
config CHIP_CHOICE
    string
    default "T5AI"

config BOARD_CHOICE
    string
    default "TUYA_T5AI_DOG"

config BOARD_CONFIG
    bool
    default y
    select ENABLE_AUDIO_CODECS
    select ENABLE_AUDIO_AEC
    select ENABLE_LED
    select ENABLE_BUTTON
```

## boards/T5AI/TUYA_T5AI_EINK_NFC/Kconfig
```kconfig
config CHIP_CHOICE
    string
    default "T5AI"

config BOARD_CHOICE
    string
    default "TUYA_T5AI_EINK_NFC"

config BOARD_CONFIG
    bool
    default y
    select ENABLE_AUDIO_CODECS
    select ENABLE_AUDIO_AEC
    select ENABLE_LED
    select ENABLE_BUTTON
    select ENABLE_BUTTON_2
    select ENABLE_BUTTON_3
    select ENABLE_BUTTON_4
    select ENABLE_BUTTON_5
    select ENABLE_BUTTON_6
    select ENABLE_DISPLAY
    select ENABLE_TP
    select ENABLE_NFC
    select ENABLE_LVGL_OS_FREERTOS if (LVGL_VERSION_9)
    select ENABLE_LVGL_DUAL_DISP_BUFF if (ENABLE_LIBLVGL)
    select ENABLE_LVGL_V8_RGB565_SWAP if (LVGL_VERSION_8 && LVGL_V8_COLOR_DEPTH_16)
```

## boards/T5AI/TUYA_T5AI_EVB/Kconfig
```kconfig
config CHIP_CHOICE
    string
    default "T5AI"

config BOARD_CHOICE
    string
    default "TUYA_T5AI_EVB"

config BOARD_CONFIG
    bool
    default y
    select ENABLE_AUDIO_CODECS
    select ENABLE_AUDIO_AEC
    select ENABLE_LED
    select ENABLE_BUTTON
    select ENABLE_BUTTON_2
    select ENABLE_DISPLAY
    select ENABLE_LVGL_OS_FREERTOS if (LVGL_VERSION_9)
    select ENABLE_LVGL_V8_RGB565_SWAP if (LVGL_VERSION_8 && LVGL_V8_COLOR_DEPTH_16)
    select ENABLE_LVGL_DUAL_DISP_BUFF if (ENABLE_LIBLVGL)
```

## boards/T5AI/TUYA_T5AI_PIXEL/Kconfig
```kconfig
config CHIP_CHOICE
    string
    default "T5AI"

config BOARD_CHOICE
    string
    default "TUYA_T5AI_PIXEL"

config BOARD_CONFIG
    bool
    default y
    select ENABLE_AUDIO_CODECS
    select ENABLE_AUDIO_AEC
    select ENABLE_LED
    select ENABLE_BUTTON
    select ENABLE_BUTTON_2
    select ENABLE_BUTTON_3
    select ENABLE_SPI
    select ENABLE_LEDS_PIXEL
    select ENABLE_IMU
    select ENABLE_IMU_BMI270
```

## boards/T5AI/TUYA_T5AI_POCKET/Kconfig
```kconfig
config CHIP_CHOICE
    string
    default "T5AI"

config BOARD_CHOICE
    string
    default "TUYA_T5AI_POCKET"

config BOARD_CONFIG
    bool
    default y
    select ENABLE_AUDIO_CODECS
    select ENABLE_AUDIO_AEC
    select ENABLE_LED
    select ENABLE_BUTTON
    select ENABLE_BUTTON_2
    select ENABLE_BUTTON_3
    select ENABLE_BUTTON_4
    select ENABLE_DISPLAY
    select ENABLE_CAMERA
    select ENABLE_JOYSTICK
    select ENABLE_PMIC
    select ENABLE_PMIC_AXP2101
    select ENABLE_IMU
    select ENABLE_IMU_BMI270
    select ENABLE_CELLULAR
    select ENABLE_LVGL_OS_FREERTOS if (LVGL_VERSION_9)  

choice TUYA_T5AI_POCKET_LCD_ROTATION
    prompt "choose TUYA_T5AI_POCKET_LCD_ROTATION lcd rotation"
    default TUYA_T5AI_POCKET_LCD_ROTATION_270
    help
        Select the rotation of the TUYA_T5AI_POCKET lcd you are using.
        
    config TUYA_T5AI_POCKET_LCD_ROTATION_0
        bool "tuya t5ai pocket lcd rotation 0"

    config TUYA_T5AI_POCKET_LCD_ROTATION_90
        bool "tuya t5ai pocket lcd rotation 90"

    config TUYA_T5AI_POCKET_LCD_ROTATION_180
        bool "tuya t5ai pocket lcd rotation 180"

    config TUYA_T5AI_POCKET_LCD_ROTATION_270
        bool "tuya t5ai pocket lcd rotation 270"
endchoice   
```

## boards/T5AI/WAVESHARE_T5AI_TOUCH_AMOLED_1_75/Kconfig
```kconfig
config CHIP_CHOICE
    string
    default "T5AI"

config BOARD_CHOICE
    string
    default "WAVESHARE_T5AI_TOUCH_AMOLED_1_75"

config BOARD_CONFIG
    bool
    default y
    select ENABLE_AUDIO_CODECS
    select ENABLE_AUDIO_AEC
    select ENABLE_BUTTON
    select ENABLE_BUTTON_2
    select ENABLE_DISPLAY
    select ENABLE_TP
    select ENABLE_LVGL_OS_FREERTOS if (LVGL_VERSION_9)
    select ENABLE_LVGL_DUAL_DISP_BUFF if (ENABLE_LIBLVGL)
    select ENABLE_LVGL_DMA2D if (ENABLE_LIBLVGL)
```
