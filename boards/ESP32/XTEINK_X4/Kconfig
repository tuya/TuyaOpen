## boards/ESP32/XTEINK_X4/Kconfig
```kconfig
config CHIP_CHOICE
    string
    default "esp32c3"

config BOARD_CHOICE
    string
    default "XTEINK_X4"

config BOARD_CONFIG
    bool
    default y
    select PLATFORM_FLASHSIZE_16M

config UART_NUM0_TX_PIN
    int "UART_NUM0_TX_PIN"
    range 0 21
    default 18
    ---help---
        Xteink X4 uses GPIO20 for USB charge sense; avoid UART on GPIO20/21 if possible.
        Default 18 may be used for console when USB-CDC is not the log output.

config UART_NUM0_RX_PIN
    int "UART_NUM0_RX_PIN"
    range 0 21
    default 19
    ---help---
        Paired with UART_NUM0_TX_PIN for UART0.
```

## boards/ESP32/bread-compact-wifi/Kconfig
```kconfig
config CHIP_CHOICE
    string
    default "esp32s3"

config BOARD_CHOICE
    string
    default "bread-compact-wifi"

config AUDIO_DRIVER_NAME
    string "the name of the audio driver"
    default "audio_driver"
```

## boards/GD32/GIGADEVICE_GD32VM553H_EVAL/Kconfig
```kconfig
config CHIP_CHOICE
    string
    default "GD32VW553H"

config BOARD_CHOICE
    string
    default "GIGADEVICE_GD32VM553H_EVAL"
```

## boards/L511C/L511C_EVB/Kconfig
```kconfig
config CHIP_CHOICE
    string
    default "L511C"

config BOARD_CHOICE
    string
    default "L511C_EVB"

config BOARD_CONFIG
    bool
    default y
```

## boards/LINUX/DshanPi_A1/Kconfig
```kconfig
menu "DshanPi A1 Board Configuration"
    config CHIP_CHOICE
        string
        default "DshanPi_A1"

    config BOARD_CHOICE
        string
        default "DshanPi_A1"

    config BOARD_CONFIG
        bool
        default y
        select ENABLE_QRCODE
        select ENABLE_AUDIO
        select ENABLE_BUTTON
        select ENABLE_AUDIO_AEC

        # Audio codec configuration for DshanPi A1 platform
    config AUDIO_CODEC_NAME
        string "Audio codec device name"
        default "alsa_audio"
        ---help---
            Name of the audio codec device. This name is used to identify
            the audio device when calling tdl_audio_find().

    config ENABLE_KEYBOARD_INPUT
        bool "Enable keyboard input for DshanPi A1"
        default y
        ---help---
            Enable keyboard input handling for DshanPi A1 platform.

    config BUTTON_NAME
        string "Keyboard button device value"
        depends on ENABLE_KEYBOARD_INPUT
        default "s"
        ---help---
            Specify the keyboard button device value for input handling.
endmenu
```

## boards/LINUX/Kconfig
```kconfig
# Ktuyaconf
config PLATFORM_CHOICE
    string
    default "LINUX"

config PLATFORM_LINUX
    bool
    default y

rsource "./TKL_Kconfig"
rsource "./OS_SERVICE_Kconfig"

config OPERATING_SYSTEM
    int
    default 100
    ---help---
        100     /* LINUX */
        98      /* RTOS */
        3       /* Non-OS */

choice
    prompt "Choice a board"

    config BOARD_CHOICE_UBUNTU
        bool "Ubuntu"
        if (BOARD_CHOICE_UBUNTU)
            rsource "./Ubuntu/Kconfig"
        endif

    config BOARD_CHOICE_RASPBERRY_PI
        bool "RaspberryPi"
        if (BOARD_CHOICE_RASPBERRY_PI)
            rsource "./Raspberry_Pi/Kconfig"
        endif

    config BOARD_CHOICE_DshanPI_A1
        bool "DshanPi A1"
        if (BOARD_CHOICE_DshanPI_A1)
            rsource "./DshanPi_A1/Kconfig"
        endif

# <new-board-add: This line cannot be deleted or modified>

endchoice
```

## boards/LINUX/Raspberry_Pi/Kconfig
```kconfig
menu "Raspberry Pi Board Configuration"
    config CHIP_CHOICE
        string
        default "Raspberry_Pi"

    config BOARD_CHOICE
        string
        default "Raspberry_Pi"

    config BOARD_CONFIG
        bool
        default y
        select ENABLE_QRCODE
        select ENABLE_AUDIO
        select ENABLE_BUTTON

    choice RASPBERRY_PI_MODEL
        prompt "Choose Raspberry Pi model"
        default RASPBERRY_PI_4
        help
            Select the Raspberry Pi model you are using.

        config RASPBERRY_PI_4
            bool "Raspberry Pi 4B"
            help
                Raspberry Pi 4 Model B with BCM2711 (ARMv8)

        config RASPBERRY_PI_5
            bool "Raspberry Pi 5"
            help
                Raspberry Pi 5 with BCM2712 (ARMv8)
    endchoice

    # Audio codec configuration for Raspberry Pi platform
    config AUDIO_CODEC_NAME
        string "Audio codec device name"
        default "alsa_audio"
        ---help---
            Name of the audio codec device. This name is used to identify
            the audio device when calling tdl_audio_find().

    config ENABLE_KEYBOARD_INPUT
        bool "Enable keyboard input for Raspberry Pi"
        default y
        ---help---
            Enable keyboard input handling for Raspberry Pi platform.

    config BUTTON_NAME
        string "Keyboard button device value"
        depends on ENABLE_KEYBOARD_INPUT
        default "s"
        ---help---
            Specify the keyboard button device value for input handling.

    config ENABLE_CAMERA
        bool "Enable Camera"
        default n

    if (ENABLE_CAMERA)
        config ENABLE_CAMERA_V4L2
            bool "Enable V4L2 USB camera"
            default y

        config CAMERA_V4L2_DEVNODE
            string "V4L2 device node"
            depends on ENABLE_CAMERA_V4L2
            default "/dev/video0"
    endif            

    config ENABLE_SDL_DISPLAY
        bool "Enable SDL2 desktop window for display"
        depends on ENABLE_DISPLAY
        default y
        ---help---
            Enable a simple SDL2 window as the display device.
            This is useful on Raspberry Pi Desktop to show LVGL UI in a small window.

    config ENABLE_SDL_TP
        bool "Enable SDL virtual touchpad (mouse drag/wheel)"
        depends on ENABLE_SDL_DISPLAY
        select ENABLE_TP
        select LVGL_ENABLE_TP
        default y
        ---help---
            Enable a virtual touchpad on Raspberry Pi Desktop.
            - Mouse left-button drag: press/move/release as single-touch
            - Mouse wheel: generates a short swipe gesture for vertical scrolling

    config SDL_DISPLAY_WIDTH
        int "SDL window width"
        depends on ENABLE_SDL_DISPLAY
        default 480

    config SDL_DISPLAY_HEIGHT
        int "SDL window height"
        depends on ENABLE_SDL_DISPLAY
        default 480

    config SDL_DISPLAY_TITLE
        string "SDL window title"
        depends on ENABLE_SDL_DISPLAY
        default "TuyaOpen - your_chat_bot"
endmenu
```

## boards/LN882H/Kconfig
```kconfig
# Ktuyaconf
config PLATFORM_CHOICE
    string
    default "LN882H"

config PLATFORM_LN882H
    bool
    default y

config OPERATING_SYSTEM
    int
    default 98
    ---help---
        100     /* LINUX */
        98      /* RTOS */
        3       /* Non-OS */

rsource "./TKL_Kconfig"
rsource "./OS_SERVICE_Kconfig"

choice
    prompt "Choice a module"

    config MODULE_CHOICE_WL2H_U
        bool "WL2H-U"
        if (MODULE_CHOICE_WL2H_U)
            rsource "./WL2H-U/Kconfig"
        endif

    config BOARD_CHOICE_EWT103_W15
        bool "EWT103-W15"
        if (BOARD_CHOICE_EWT103_W15)
            rsource "./EWT103-W15/Kconfig"
        endif
endchoice
```

## boards/T2/Kconfig
```kconfig
# Ktuyaconf
config PLATFORM_CHOICE
    string
    default "T2"

config PLATFORM_T2
    bool
    default y

config OPERATING_SYSTEM
    int
    default 98
    ---help---
        100     /* LINUX */
        98      /* RTOS */
        3       /* Non-OS */

rsource "./TKL_Kconfig"
rsource "./OS_SERVICE_Kconfig"

choice
    prompt "Choice a board"

    config BOARD_CHOICE_T2_U
        bool "T2-U"
        if (BOARD_CHOICE_T2_U)
            rsource "./T2-U/Kconfig"
        endif

# <new-board-add: This line cannot be deleted or modified>

endchoice
```

## boards/T2/T2-U/Kconfig
```kconfig
config BOARD_CHOICE
    string
    default "T2-U"

config BOARD_CONFIG
    bool
    default y
    select ENABLE_LED
    select ENABLE_BUTTON
```

## boards/T3/Kconfig
```kconfig
# Ktuyaconf
config PLATFORM_CHOICE
    string
    default "T3"

config PLATFORM_T3
    bool
    default y

config OPERATING_SYSTEM
    int
    default 98
    ---help---
        100     /* LINUX */
        98      /* RTOS */

rsource "./TKL_Kconfig"
rsource "./OS_SERVICE_Kconfig"

choice
    prompt "Choice a board"

    config BOARD_CHOICE_T3_LCD_DEVKIT
        bool "T3_LCD_DEVKIT"
        if (BOARD_CHOICE_T3_LCD_DEVKIT)
            rsource "./T3_LCD_DEVKIT/Kconfig"
        endif

# <new-board-add: This line cannot be deleted or modified>

endchoice
```

## boards/T3/T3_LCD_DEVKIT/Kconfig
```kconfig
config CHIP_CHOICE
    string
    default "T3"

config BOARD_CHOICE
    string
    default "T3_LCD_DEVKIT"

config BOARD_CONFIG
    bool
    default y
    select ENABLE_DISPLAY
    select ENABLE_TP
    select ENABLE_LVGL_V8_RGB565_SWAP if (LVGL_VERSION_8 && LVGL_V8_COLOR_DEPTH_16)
```

## boards/T5AI/ATK_T5AI_MINI_BOARD/Kconfig
```kconfig
config CHIP_CHOICE
    string
    default "T5AI"

config BOARD_CHOICE
    string
    default "ATK_T5AI_MINI_BOARD"

config BOARD_CONFIG
    bool
    default y
    select ENABLE_AUDIO_CODECS
    select ENABLE_AUDIO_AEC
    select ENABLE_LED
    select ENABLE_BUTTON

choice ATK_T5AI_MINI_BOARD_EX_LCD_MODULE
    prompt "choose expansion lcd module for ATK_T5AI_MINI_BOARD"
    default ATK_T5AI_MINI_BOARD_LCD_MD0240_SPI

    config ATK_T5AI_MINI_BOARD_LCD_MD0240_SPI
        bool "support 2.4 inch spi LCD module"
        select ENABLE_DISPLAY
        select ENABLE_LVGL_V8_RGB565_SWAP if (LVGL_VERSION_8 && LVGL_V8_COLOR_DEPTH_16)
        select ENABLE_LVGL_DUAL_DISP_BUFF if (ENABLE_LIBLVGL)
        select ENABLE_LVGL_OS_FREERTOS if (LVGL_VERSION_9)

    config ATK_T5AI_MINI_BOARD_LCD_MD0700R_RGB
        bool "support 7 inch rgb LCD module"
        select ENABLE_DISPLAY
        select ENABLE_TP
        select ENABLE_LVGL_DUAL_DISP_BUFF if (ENABLE_LIBLVGL)
        select ENABLE_LVGL_OS_FREERTOS if (LVGL_VERSION_9)

    config ATK_T5AI_MINI_BOARD_LCD_MD0430R_RGB
        bool "support 4.3 inch rgb LCD module"
        select ENABLE_DISPLAY
        select ENABLE_TP
        select ENABLE_LVGL_DUAL_DISP_BUFF if (ENABLE_LIBLVGL)
        select ENABLE_LVGL_OS_FREERTOS if (LVGL_VERSION_9)

    config ATK_T5AI_MINI_BOARD_LCD_NONE
        bool "no expansion lcd module"
endchoice

choice ATK_T5AI_MINI_BOARD_EX_CAMERA_MODULE
    prompt "choose expansion camera module for ATK_T5AI_MINI_BOARD"
    default ATK_T5AI_MINI_BOARD_CAMERA_OV2640

    config ATK_T5AI_MINI_BOARD_CAMERA_OV2640
        bool "support OV2640 camera module"
        select ENABLE_CAMERA

    config ATK_T5AI_MINI_BOARD_CAMERA_OV5640
        bool "support OV5640 camera module"
        select ENABLE_CAMERA

    config ATK_T5AI_MINI_BOARD_CAMERA_NONE
        bool "no expansion camera module"
endchoice
```

## boards/T5AI/Kconfig
```kconfig
# Ktuyaconf
config PLATFORM_CHOICE
    string
    default "T5AI"

config PLATFORM_T5
    bool
    default y

config ENABLE_BIG_CORE
    bool
    default y

config OPERATING_SYSTEM
    int
    default 98
    ---help---
        100     /* LINUX */
        98      /* RTOS */

rsource "./TKL_Kconfig"

rsource "./OS_SERVICE_Kconfig"

choice
    prompt "Choice a board"

    config BOARD_CHOICE_TUYA_T5AI_BOARD
        bool "TUYA_T5AI_BOARD"
        if (BOARD_CHOICE_TUYA_T5AI_BOARD)
            rsource "./TUYA_T5AI_BOARD/Kconfig"
        endif

    config BOARD_CHOICE_TUYA_T5AI_EVB
        bool "TUYA_T5AI_EVB"
        if (BOARD_CHOICE_TUYA_T5AI_EVB)
            rsource "./TUYA_T5AI_EVB/Kconfig"
        endif

    config BOARD_CHOICE_TUYA_T5AI_CORE
        bool "TUYA_T5AI_CORE"
        if (BOARD_CHOICE_TUYA_T5AI_CORE)
            rsource "./TUYA_T5AI_CORE/Kconfig"
        endif

    config BOARD_CHOICE_T5AI_MINI
        bool "T5AI_MINI"
        if (BOARD_CHOICE_T5AI_MINI)
            rsource "./T5AI_MINI/Kconfig"
        endif

    config BOARD_CHOICE_T5AI_MOJI_1_28
        bool "T5AI_MOJI_1_28"
        if (BOARD_CHOICE_T5AI_MOJI_1_28)
            rsource "./T5AI_MOJI_1_28/Kconfig"
        endif

    config BOARD_CHOICE_TUYA_T5AI_POCKET
        bool "TUYA_T5AI_POCKET"
        if (BOARD_CHOICE_TUYA_T5AI_POCKET)
            rsource "./TUYA_T5AI_POCKET/Kconfig"
        endif


    config BOARD_CHOICE_ATK_T5AI_MINI_BOARD
        bool "ATK_T5AI_MINI_BOARD"
        if (BOARD_CHOICE_ATK_T5AI_MINI_BOARD)
            rsource "./ATK_T5AI_MINI_BOARD/Kconfig"
        endif


    config BOARD_CHOICE_WAVESHARE_T5AI_TOUCH_AMOLED_1_75
        bool "WAVESHARE_T5AI_TOUCH_AMOLED_1_75"
        if (BOARD_CHOICE_WAVESHARE_T5AI_TOUCH_AMOLED_1_75)
            rsource "./WAVESHARE_T5AI_TOUCH_AMOLED_1_75/Kconfig"
        endif

    config BOARD_CHOICE_T5AI_OTTO
        bool "T5AI_OTTO"
        if (BOARD_CHOICE_T5AI_OTTO)
            rsource "./T5AI_OTTO/Kconfig"
        endif

    config BOARD_CHOICE_TUYA_T5AI_PIXEL
        bool "TUYA_T5AI_PIXEL"
        if (BOARD_CHOICE_TUYA_T5AI_PIXEL)
            rsource "./TUYA_T5AI_PIXEL/Kconfig"
        endif

    config BOARD_CHOICE_TUYA_T5AI_DESKTOP_ROBOT
        bool "TUYA_T5AI_DESKTOP_ROBOT"
        if (BOARD_CHOICE_TUYA_T5AI_DESKTOP_ROBOT)
            rsource "./TUYA_T5AI_DESKTOP_ROBOT/Kconfig"
        endif

    config BOARD_CHOICE_TUYA_T5AI_DOG
        bool "TUYA_T5AI_DOG"
        if (BOARD_CHOICE_TUYA_T5AI_DOG)
            rsource "./TUYA_T5AI_DOG/Kconfig"
        endif

# <new-board-add: This line cannot be deleted or modified>

endchoice
```

## boards/T5AI/T5AI_MINI/Kconfig
```kconfig
config CHIP_CHOICE
    string
    default "T5AI"

config BOARD_CHOICE
    string
    default "T5AI_MINI"

config BOARD_CONFIG
    bool
    default y
    select ENABLE_AUDIO_CODECS
    select ENABLE_AUDIO_AEC


choice T5AI_MINI_EX_MODULE
    prompt "choose expansion module for T5AI_MINI"
    default T5AI_MINI_EX_MODULE_NONE

    config T5AI_MINI_EX_MODULE_NONE
        bool "no expansion module"

    config T5AI_MINI_EX_MODULE_13565LCD
        bool "1.54 inch 240x240 spi LCD"
        select ENABLE_DISPLAY
        select ENABLE_LVGL_DUAL_DISP_BUFF if (ENABLE_LIBLVGL)
        select ENABLE_LVGL_OS_FREERTOS if (LVGL_VERSION_9)
    config T5AI_MINI_EX_MODULE_ST7735S_XLT
        bool "ST7735S XLT 160x80 spi LCD"
        select ENABLE_DISPLAY
        select ENABLE_LVGL_DUAL_DISP_BUFF if (ENABLE_LIBLVGL)
	    select ENABLE_LVGL_OS_FREERTOS if (LVGL_VERSION_9)
endchoice
```

## boards/T5AI/T5AI_MOJI_1_28/Kconfig
```kconfig
config CHIP_CHOICE
    string
    default "T5AI"

config BOARD_CHOICE
    string
    default "T5AI_MOJI_1_28"

config BOARD_CONFIG
    bool
    default y
    select ENABLE_AUDIO_CODECS
    select ENABLE_AUDIO_AEC
    select ENABLE_LED
    select ENABLE_BUTTON
    select ENABLE_DISPLAY
    select ENABLE_LVGL_V8_RGB565_SWAP if (LVGL_VERSION_8 && LVGL_V8_COLOR_DEPTH_16)
    select ENABLE_LVGL_DUAL_DISP_BUFF if (ENABLE_LIBLVGL)
    select ENABLE_LVGL_OS_FREERTOS if (LVGL_VERSION_9)
```
