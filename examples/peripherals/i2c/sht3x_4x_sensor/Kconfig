## examples/peripherals/i2c/sht3x_4x_sensor/Kconfig
```kconfig
menu "Application config"

    config EXAMPLE_I2C_PORT
        int "i2c port"
        default 0
        range 0 3

    choice EXAMPLE_I2C_SENSOR_TYPE
        prompt "sensor type"
        default EXAMPLE_I2C_SENSOR_SHT3X
        
        config EXAMPLE_I2C_SENSOR_SHT3X
            bool "sht3x"
        config EXAMPLE_I2C_SENSOR_SHT4X
            bool "sht4x"
    endchoice
endmenu
```

## examples/peripherals/pinmux/Kconfig
```kconfig
menu "Pinmux example"

    config EXAMPLE_PINMUX_I2C_PORT
        int "I2C controller index"
        default 0
        range 0 5
        ---help---
            The selected platform validates whether this I2C controller exists.

    config EXAMPLE_PINMUX_I2C_SCL_PIN
        int "I2C SCL GPIO"
        default 0
        range 0 60

    config EXAMPLE_PINMUX_I2C_SDA_PIN
        int "I2C SDA GPIO"
        default 1
        range 0 60

endmenu
```

## examples/peripherals/pwm/Kconfig
```kconfig
menu "Application config"

    config EXAMPLE_PWM_PORT
        int "pwm port"
        default 1
        range 0 11

    config EXAMPLE_PWM_DUTY
        int "pwm duty"
        default 2000
        range 0 10000

    config EXAMPLE_PWM_FREQUENCY
        int "pwm frequency"
        default 10000

    config EXAMPLE_PWM_POLARITY
        int "pwm polarity (0: negative, duty is the low time; 1: positive, duty is the high time)"
        default 1
        range 0 1

endmenu
```

## examples/peripherals/qspi/Kconfig
```kconfig
menu "Application config"

    config EXAMPLE_QSPI_PORT
        int "qspi port"
        default 0
        range 0 1

    config EXAMPLE_QSPI_FREQ_HZ
        int "qspi clock in Hz"
        default 1000000
        range 100000 100000000
        ---help---
            Left low on purpose. With no memory attached there is nothing to keep up with,
            and a slow clock is what makes the trace readable - flying leads and a single
            ground turn a fast bus into crosstalk long before the controller is the problem.

    config EXAMPLE_QSPI_USE_DMA
        bool "use QSPI DMA for payload transfers"
        default n

    config EXAMPLE_QSPI_QUAD
        bool "also issue a transaction with the data phase on four lines"
        default n
        ---help---
            Enable this to issue the four-line payload transaction.  Pin mapping itself
            remains board-owned; on GD32H779V_START IO2/IO3 are PE9 and PE10.

endmenu
```

## examples/peripherals/sd/Kconfig
```kconfig
menu "Application config"

    config EXAMPLE_SD_MOUNT_PATH
        string "SD card mount path"
        default "/sdcard"

endmenu
```

## examples/peripherals/spi/Kconfig
```kconfig
menu "Application config"

    config EXAMPLE_SPI_PORT
        int "spi port"
        default 0
        range 0 5

    config EXAMPLE_SPI_BAUDRATE
        int "spi baudrate"
        default 1000000
        range 1 100000000

    config EXAMPLE_SPI_IRQ_ENABLE
        bool "use asynchronous SPI IRQ mode"
        default n

    config EXAMPLE_SPI_DMA
        bool "use SPI DMA mode"
        default n

endmenu
```

## examples/peripherals/timer/Kconfig
```kconfig
menu "Application config"

    config EXAMPLE_TIMER_ID
        int "timer id"
        default 0
        range 0 5
endmenu
```

## examples/peripherals/uart/Kconfig
```kconfig
menu "Application config"

    config EXAMPLE_UART_NUM
        int "uart port"
        default 0
        range 0 7

    config EXAMPLE_UART_BAUDRATE
        int "uart baudrate"
        default 115200

    config EXAMPLE_LOW_POWER
        bool "let the cpu sleep while waiting for input"
        default n
        ---help---
            The read below blocks, so with this on the core is idle between bytes and free
            to sleep. Whether a byte can then wake it back up is exactly what this is for:
            on a platform whose sleep stops the uart's clock, it cannot, and the echo goes
            quiet until something else happens.

endmenu
```

## src/Kconfig
```kconfig
# Ktuyaconf
menu "configure tuyaopen"
    rsource "common/Kconfig"
    rsource "ai_components/Kconfig"
    rsource "audio_player/Kconfig"
    rsource "liblvgl/Kconfig"
    rsource "libu8g2/Kconfig"
    rsource "libjpegturbo/Kconfig"
    rsource "micropython/Kconfig"
    rsource "peripherals/Kconfig"
    rsource "image_album/Kconfig"
    # 服务组件（core 未覆盖的上游组件，统一收编在 src/tuya_service/）
    rsource "tuya_service/tal_cli/Kconfig"
    rsource "tuya_service/liblwip/Kconfig"
    rsource "tuya_service/tal_wifi_ulp/Kconfig"
    rsource "tuya_service/tuya_pm/Kconfig"
endmenu
```

## src/ai_components/Kconfig
```kconfig
config ENABLE_AI_COMPONENTS
    bool "enable ai components"
    default n
    help
        Master switch for the tuya.ai component collection (ai_main, ai_agent,
        ai_audio, ai_ui, ...). Leave off for projects that do not need it so it
        is not compiled in.

if (ENABLE_AI_COMPONENTS)
menu "configure ai components"
    choice
        prompt "choose ai language"
        default ENABLE_AI_LANGUAGE_CHINESE

        config ENABLE_AI_LANGUAGE_CHINESE
            bool "Chinese"

        config ENABLE_AI_LANGUAGE_ENGLISH
            bool "English"
    endchoice

    config ENABLE_AI_ALERT_TONE
        bool "use language-neutral alert tones instead of speech"
        default y
        help
            Play short language-neutral tones for all local alerts instead of
            the localized voice pack (Chinese/English speech). While enabled,
            the localized speech packs are excluded from the build entirely.
            Set to n to restore the voice prompts.

    rsource "ai_mode/Kconfig"
    rsource "ai_audio/Kconfig"
    rsource "ai_mcp/Kconfig"
    rsource "ai_video/Kconfig"
    rsource "ai_picture/Kconfig"
    rsource "ai_ui/Kconfig"
endmenu
endif
```

## src/ai_components/ai_audio/Kconfig
```kconfig
menuconfig ENABLE_COMP_AI_AUDIO
    select ENABLE_AI_PLAYER
    bool "enable ai audio input/output"
    default y

if (ENABLE_COMP_AI_AUDIO)
    choice
        prompt "select ai audio input codec"
        default ENABLE_COMP_AI_AUDIO_CODEC_PCM

    config ENABLE_COMP_AI_AUDIO_CODEC_PCM
        bool "enable ai audio pcm codec"

    config ENABLE_COMP_AI_AUDIO_CODEC_OPUS
        select ENABLE_TUYA_CODEC
        select ENABLE_TUYA_CODEC_OPUS
        bool "enable ai audio opus codec"

    config ENABLE_COMP_AI_AUDIO_CODEC_SPEEX
        select ENABLE_TUYA_CODEC
        select ENABLE_TUYA_CODEC_SPEEX
        bool "enable ai audio speex codec"

    endchoice

    choice 
        prompt "select player alert source"
        default AI_PLAYER_ALERT_SOURCE_LOCAL

    config AI_PLAYER_ALERT_SOURCE_LOCAL
        bool "use local alert source"
        help
          Use locally embedded MP3 resources for alert sounds.
          Resources are compiled into the binary.

    config AI_PLAYER_ALERT_SOURCE_CLOUD
        bool "use cloud alert source"
        select AI_AGENT_ENABLE_CLOUD_ALERT
        help
          Use cloud-based alert sounds. Falls back to local dingdong
          sound when cloud is unavailable.

    config AI_PLAYER_ALERT_SOURCE_CUSTOM
        bool "use custom alert source"
        help
          Use a product-registered callback for alert sounds.

    endchoice

endif
```

## src/liblvgl/Kconfig
```kconfig
menuconfig ENABLE_LIBLVGL
    bool "configure enable/disable liblvgl"
    select ENABLE_DISPLAY
    default n

    if (ENABLE_LIBLVGL)
        choice LIBLVGL_VERSION
            prompt "the version of the lvgl lib"
            default LVGL_VERSION_9

            config LVGL_VERSION_8
                bool "LVGL 8"
            config LVGL_VERSION_9
                bool "LVGL 9"
        endchoice

        if(LVGL_VERSION_8)
            choice LIBLVGL_V8_COLOR_DEPTH
                prompt "the color depth of the lvgl v8"
                default LVGL_V8_COLOR_DEPTH_16

                config LVGL_V8_COLOR_DEPTH_16
                    bool "16-bit color"
                config LVGL_V8_COLOR_DEPTH_24
                    bool "24-bit color"
            endchoice
        endif

        config LVGL_COLOR_DEPTH
            int "the color depth of the lvgl (1, 8, 16, 24, 32)"
            default 16
            help
                Color depth:
                1  : 1 byte per pixel (I1)
                8  : 8-bit (L8 / RGB332)
                16 : 16-bit (RGB565)
                24 : 24-bit (RGB888)
                32 : 32-bit (XRGB8888 / ARGB8888)

        config ENABLE_LVGL_OS_FREERTOS
            bool "enable lvgl os freertos"
            depends on LVGL_VERSION_9
            default n

        config ENABLE_LVGL_TP
            bool "enable lvgl tp"
            select ENABLE_TP
            default n

        config ENABLE_LVGL_DEMO
            bool "enable lvgl demo"
            default n

        config ENABLE_LVGL_MONITOR
            bool "enable lvgl monitor"
            default n

        config ENABLE_LVGL_ENCODER
            bool "enable lvgl encoder"
            select ENABLE_ENCODER
            default n

        config ENABLE_LVGL_LODEPNG
            bool "enable lvgl LODEPNG decoder library"
            default n

        choice LIBLVGL_FLUSH_MODE
            prompt "the lvgl flush mode"
            default ENABLE_LVGL_FULL_FLUSH

            config ENABLE_LVGL_PARTIAL_FLUSH
                bool "partial flush: render dirty regions, send each one"
                help
                    LVGL renders small dirty-region buffers, the port sends
                    every region straight to the driver. Lowest memory, works
                    on all panels.

            config ENABLE_LVGL_FULL_FLUSH
                bool "full-frame flush: render small, copy into pool fb"
                help
                    LVGL renders small buffers, the port copies them into a
                    full-frame fb from the fb pool, then flushes the pool fb.

            config ENABLE_LVGL_DIRECT_FLUSH
                bool "direct flush: render into driver vram, zero-copy"
                help
                    LVGL renders straight into the display driver's internal
                    frame buffers (tdl_disp_get_vram, needs >= 2 fbs, e.g. RGB
                    panel in direct-scan mode). Zero copy, anti-tearing: the
                    flush waits for the scan switch. Init fails when the
                    driver cannot provide the fbs - no fallback.
        endchoice

        config ENABLE_LVGL_DUAL_DISP_BUFF
            bool "enable lvgl dual display buffer"
            depends on ENABLE_LVGL_FULL_FLUSH
            default n

        config ENABLE_LVGL_DRAW_BUF_PSRAM
            bool "allocate LVGL draw buffer from PSRAM"
            depends on ENABLE_EXT_RAM
            default y
            help
                When enabled, LVGL draw buffers are allocated from PSRAM
                (via tkl_system_psram_malloc). Disable this to use internal SRAM
                for higher rendering throughput on RGB parallel displays.

        choice
            prompt "the proportion of the draw buffer size"

            config LV_DRAW_BUF_PROPORTION_10
                bool "10% of the display size"
            config LV_DRAW_BUF_PROPORTION_5
                bool "5% of the display size"
        endchoice

        config LV_DRAW_BUF_PARTS
            int
            default 10 if LV_DRAW_BUF_PROPORTION_10
            default 20 if LV_DRAW_BUF_PROPORTION_5

        # Font configuration
        rsource "Fonts_Kconfig"

        # PC Simulator
        rsource "simulator/Kconfig"
    endif
```

## src/peripherals/camera/Kconfig
```kconfig
config ENABLE_CAMERA
    bool "enable camera"
    default n

if (ENABLE_CAMERA)
    config CAMERA_NAME
        string "the name of camera 1"
        default "camera"

    config ENABLE_CAMERA_2
        bool "enable camera 2"
        default n

    config CAMERA_NAME_2
        string "the name of camera 2"
        default "camera2"
        depends on ENABLE_CAMERA_2

    config CAMERA_RAW_FRAME_BUFF_CNT
        int "raw frame buffer count"
        range 1 4
        default 2
endif
```

## src/peripherals/display/Kconfig
```kconfig
config ENABLE_DISPLAY
    bool "enable display"
    default n

if (ENABLE_DISPLAY)
    config DISPLAY_NAME
        string "the name of display 1"
        default "display"

    config ENABLE_DISPLAY_2
        bool "enable second display device"
        default n

    config DISPLAY_NAME_2
        string "the name of display 2"
        default "display2"
        depends on ENABLE_DISPLAY_2

    config DISPLAY_DEFAULT_BRIGHTNESS
        int "Default backlight brightness when opening display (0-100)"
        range 0 100
        default 100
        help
            Applied by tdl_disp_dev_open() after backlight hardware is initialized.
            0 turns backlight off where supported; 100 is maximum. For GPIO on/off
            backlight, any non-zero value turns the backlight on.

    config ENABLE_MIPI_DSI
        bool "enable MIPI-DSI display bus"
        default n
        help
            MIPI-DSI panel support. A DSI panel has no GRAM and is refreshed
            continuously from a host-side frame buffer, so the driver shape
            follows the RGB one rather than the SPI/I2C command buses.
endif
```

## src/peripherals/encoder/Kconfig
```kconfig
config ENABLE_ENCODER
    bool "enable encoder"
    default n

if (ENABLE_ENCODER)
    config ENCODER_NAME
        string "the name of encoder"
        default "encoder"

    config ENCODER_MAX_DEVICES
        int "maximum encoder devices"
        range 1 16
        default 4

    config ENCODER_TASK_STACK_SIZE
        int "encoder task stack size"
        range 1024 8192
        default 2048
endif
```

## src/peripherals/imu/Kconfig
```kconfig
config ENABLE_IMU
    bool "Enable IMU"
    default n

if (ENABLE_IMU)
    config ENABLE_IMU_BMI220
        bool "Enable bmi220 (chip_id 0x26, requires bmi260 config firmware)"
        default y

    config ENABLE_IMU_BMI270
        bool "Enable bmi270 (chip_id 0x24, requires bmi270 config firmware)"
        default y

    config ENABLE_IMU_SC7A20
        bool "Enable SC7A20 accelerometer"
        default n
endif
```

## src/peripherals/ir/Kconfig
```kconfig
config ENABLE_IR
    bool "enable IR"
    default n

if (ENABLE_IR)
    config IR_NAME
        string "the name of the IR device"
        default "ir_dev"
endif
```

## src/peripherals/led/Kconfig
```kconfig
config ENABLE_LED
    bool "enable led"
    default n

if (ENABLE_LED)
    config LED_NAME
        string "the name of led 1"
        default "led"

    config ENABLE_LED_2
        bool "enable led 2"
        default n

    config LED_NAME_2
        string "the name of led 2"
        default "led2"
        depends on ENABLE_LED_2

    config ENABLE_LED_3
        bool "enable led 3"
        default n
        depends on ENABLE_LED_2

    config LED_NAME_3
        string "the name of led 3"
        default "led3"
        depends on ENABLE_LED_3

    config ENABLE_LED_4
        bool "enable led 4"
        default n
        depends on ENABLE_LED_3

    config LED_NAME_4
        string "the name of led 4"
        default "led4"
        depends on ENABLE_LED_4
endif
```

## src/peripherals/motion/Kconfig
```kconfig
config ENABLE_MOTION
    bool "Enable motion sensor"
    default n
    depends on !ENABLE_IMU

if (ENABLE_MOTION)
    config MOTION_NAME
        string "the name of motion sensor"
        default "motion"

    config MOTION_MAX_DEVICES
        int "maximum motion devices"
        range 1 16
        default 4

    config ENABLE_MOTION_SC7A20
        bool "Enable SC7A20 accelerometer"
        default n

    config ENABLE_MOTION_BMI270
        bool "Enable BMI270 accelerometer and gyroscope"
        default n
endif
```

## src/peripherals/power/Kconfig
```kconfig
config ENABLE_POWER
    bool "Enable power"
    default n

if (ENABLE_POWER)
    config POWER_NAME
        string "the name of the power device"
        default "power"
endif
```
