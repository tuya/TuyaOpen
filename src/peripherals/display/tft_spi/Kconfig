## tools/porting/template/Kconfig
```kconfig
menu "configure platform <your-platform-name>"

    choice
        prompt "OPERATING_SYSTEM"
        default OPERATING_SYSTEM_RTOS

        config OPERATING_SYSTEM_LINUX
            bool "LINUX"
        config OPERATING_SYSTEM_RTOS
            bool "RTOS"
    endchoice

    config OPERATING_SYSTEM
        int
        default 100 if OPERATING_SYSTEM_LINUX
        default 98 if OPERATING_SYSTEM_RTOS

    choice
        prompt "ENDIAN"
        default TUYA_LITTLE_ENDIAN

        config TUYA_LITTLE_ENDIAN
            bool "LITTLE_ENDIAN"
        config BIG_ENDIAN
            bool "BIG_ENDIAN"
    endchoice

    config LITTLE_END
        int
        default 1 if TUYA_LITTLE_ENDIAN
        default 0 if TUYA_BIG_ENDIAN

    config ENABLE_FILE_SYSTEM
        bool "ENABLE_FILE_SYSTEM --- support filesystem"
        default y if OPERATING_SYSTEM = 100
        default n if OPERATING_SYSTEM = 98

    config ENABLE_WIFI
        bool "ENABLE_WIFI --- support wifi"
        default n

    config ENABLE_WIRED
        bool "ENABLE_WIRED --- support wired"
        default y

    menuconfig ENABLE_BLUETOOTH
        bool "ENABLE_BLUETOOTH --- support BLE"
        default n
        if (ENABLE_BLUETOOTH)
            config ENABLE_HCI
                bool "ENABLE_HCI --- support BLE hci"
                default n
        endif
    config ENABLE_RTC
        bool "ENABLE_RTC --- support rtc"
        default n

    config ENABLE_WATCHDOG
        bool "ENABLE_WATCHDOG --- support watchdog"
        default n

    config ENABLE_UART
        bool "ENABLE_UART --- support uart"
        default y

    menuconfig ENABLE_FLASH
        bool "ENABLE_FLASH --- support flash"
        default y

        if (ENABLE_FLASH)
            config TUYA_FLASH_TYPE_MAX_PARTITION_NUM
                int "TUYA_FLASH_TYPE_MAX_PARTITION_NUM --- max support flash parttion number"
                default 10
        endif
    config ENABLE_ADC
        bool "ENABLE_ADC --- support adc"
        default n

    config ENABLE_PWM
        bool "ENABLE_PWM --- support pwm"
        default n

    config ENABLE_GPIO
        bool "ENABLE_GPIO --- support gpio"
        default y

    config ENABLE_I2C
        bool "ENABLE_I2C --- support i2c"
        default n

    config ENABLE_TIMER
        bool "ENABLE_TIMER --- support hw timer"
        default n

    config ENABLE_SPI
        bool "ENABLE_SPI --- support spi"
        default n

    config ENABLE_QSPI
        bool "ENABLE_QSPI --- support qspi"
        default n

    config ENABLE_RGB
        bool "ENABLE_RGB --- support LCD rgb interface"
        default n

    config ENABLE_MCU8080
        bool "ENABLE_MCU8080 --- support LCD mcu8080 interface"
        default n

    config ENABLE_MEDIA
        bool "ENABLE_MEDIA --- support media"
        default n

    config ENABLE_VAD
        bool "ENABLE_VAD --- support voice activity detection"
        default n

    config ENABLE_ASR
        bool "ENABLE_ASR --- support automatic speech recognition"
        default n

    config ENABLE_STORAGE
        bool "ENABLE_STORAGE --- support storage such as SDCard"
        default n

    config ENABLE_EXT_RAM
        bool "ENABLE_EXT_RAM --- support external ram ex: PSRAM"
        default n

    config ENABLE_DAC
        bool "ENABLE_DAC --- support dac"
        default n

    config ENABLE_I2S
        bool "ENABLE_I2S --- support i2s"
        default n

    config ENABLE_WAKEUP
        bool "ENABLE_WAKEUP --- support lowpower wakeup"
        default n

    config ENABLE_REGISTER
        bool "ENABLE_REGISTER --- support register"
        default n

    config ENABLE_PINMUX
        bool "ENABLE_PINMUX --- support pinmux"
        default n

    config ENABLE_PLATFORM_AES
        bool "ENABLE_PLATFORM_AES --- support hw AES"
        default n

    config ENABLE_PLATFORM_SHA256
        bool "ENABLE_PLATFORM_SHA256 --- support hw sha256"
        default n

    config ENABLE_PLATFORM_MD5
        bool "ENABLE_PLATFORM_MD5 --- support hw md5"
        default n

    config ENABLE_PLATFORM_SHA1
        bool "ENABLE_PLATFORM_SHA1 --- support hw sha1"
        default n

    config ENABLE_PLATFORM_RSA
        bool "ENABLE_PLATFORM_RSA --- support hw rsa"
        default n

    config ENABLE_PLATFORM_ECC
        bool "ENABLE_PLATFORM_ECC --- support hw ecc"
        default n

    endmenu
```
