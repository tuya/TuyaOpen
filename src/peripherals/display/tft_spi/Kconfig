## src/peripherals/display/tft_spi/Kconfig
```kconfig
if (ENABLE_DISPLAY_DRIVER)
if (ENABLE_DISPLAY_LCD_SPI)
    choice 
        prompt "choose tft lcd chip"
        default ENABLE_LCD_SPI_ST7789

        config ENABLE_LCD_SPI_ST7789
            bool "st7789"

        config ENABLE_LCD_SPI_GC9A01
            bool "gc9a01"

        config ENABLE_LCD_SPI_ILI9341
            bool "ili9341"
    endchoice

    menu "configure tft lcd driver"
        config LCD_SPI_PORT
            int "tft lcd spi port"
            range 0 5
            default 0

        config LCD_SPI_CLK
            int "tft lcd spi spi freq"
            default 48000000
            
        config LCD_SPI_CS_PIN
            int "tft lcd cs pin"
            range 0 64
            default 40

        config LCD_SPI_DC_PIN
            int "tft lcd dc pin"
            range 0 64
            default 15

        config LCD_SPI_RST_PIN
            int "tft lcd rst pin"
            range 0 64
            default 17
    endmenu
endif
endif
```

## src/peripherals/joystick/Kconfig
```kconfig
config ENABLE_JOYSTICK
    bool "enable joystick"
    default n

if (ENABLE_JOYSTICK)
    config JOYSTICK_BUTTON_NUM
        int "the num of joystick button"
        range 0 36
        default 7   

    config JOYSTICK_STICK_NUM1
        int "the num of joystick stick 1"
        range 0 36
        default 22

    config JOYSTICK_STICK_NUM2
        int "the num of joystick stick 2"
        range 0 36
        default 24

    config JOYSTICK_NAME
        string "the name of joystick button"
        default "joystick"

    config STICK_NAME1
        string "the name of stick 1"
        default "stick1"

    config STICK_NAME2
        string "the name of stick 2"
        default "stick2"

endif
```

## src/peripherals/leds_pixel/Kconfig
```kconfig
config ENABLE_LEDS_PIXEL
    bool "enable leds pixel driver"
    default n

if (ENABLE_LEDS_PIXEL)
    config LEDS_PIXEL_NAME
        string "the name of led pixel 1"
        default "led_pixel"
endif
```

## src/peripherals/nfc/Kconfig
```kconfig
config ENABLE_NFC
    bool "Enable NFC"
    default n

if (ENABLE_NFC)
    config ENABLE_NFC_PN532
        bool "Enable PN532"
        default y
endif
```

## src/peripherals/pmic/Kconfig
```kconfig
config ENABLE_PMIC
    bool "Enable PMIC"
    default n

if (ENABLE_PMIC)
    config ENABLE_PMIC_AXP2101
        bool "Enable axp2101"
        default y

    config ENABLE_PMIC_M5PM1
        bool "Enable M5PM1"
        default n
endif
```

## src/peripherals/printer/Kconfig
```kconfig
config ENABLE_PRINTER
    bool "enable printer"
    default n

if (ENABLE_PRINTER)
    config PRINTER_NAME
        string "the name of printer"
        default "printer"

    config PRINTER_STACK_SIZE
        int "printer task stack size"
        default 4096
        range 1024 16384

    config PRINTER_POLL_INTERVAL_MS
        int "printer status poll interval (ms)"
        default 500
        range 100 5000

    config ENABLE_PRINTER_UART
        bool "enable printer uart"
        default y

    config PRINTER_UART_BAUDRATE
        int "printer uart baudrate"
        default 19200
        range 2400 115200
        depends on ENABLE_PRINTER_UART

    config ENABLE_PRINTER_MTP02
        bool "enable MTP02-DXD thermal printer mechanism driver"
        default n

    config PRINTER_MTP02_STROBE_MS
        int "MTP02 thermal head strobe time (ms)"
        default 1
        range 1 10
        depends on ENABLE_PRINTER_MTP02

    config PRINTER_MTP02_MOTOR_STEP_MS
        int "MTP02 motor step interval (ms)"
        default 3
        range 1 10
        depends on ENABLE_PRINTER_MTP02

    config ENABLE_PRINTER_DP48
        bool "enable DP48A ESC/POS UART printer driver"
        default n

    config PRINTER_TEAR_FEED_LINES
        int "paper feed lines after each print job (tear-off strip), 0 = disabled"
        default 0
        range 0 5000
        help
          When non-zero, tdl_printer_end() automatically advances the
          paper by this many dot-rows so the printed content clears
          the tear bar. Set to 0 to disable (the application can still
          call tdl_printer_paper_feed() explicitly).
          Note: on some thermal printers the ESC d n command's "n"
          parameter is interpreted as millimetres rather than dot-rows;
          if you see excessive paper feed at the default value, lower
          this number or set it to 0.
endif
```

## src/peripherals/touch/Kconfig
```kconfig
config ENABLE_TOUCH
    depends on !ENABLE_PLATFORM_LVGL
    depends on ENABLE_DISPLAY
    bool "enable touch driver"
    default n
```

## src/peripherals/tp/Kconfig
```kconfig
config ENABLE_TP
    bool "enable touchpad driver"
    depends on ENABLE_DISPLAY
    default n
```

## src/tal_at_modem/Kconfig
```kconfig
menu "AT modem"
	menuconfig ENABLE_AT_MODEM
		bool "ENABLE_AT_MODEM: enable liblwip instead of lwip in board"
		default n
		if (ENABLE_AT_MODEM)
			config AT_TRANSPORT_NAME
			string "AT transport name"
			default "AT_TRANSPORT"
		endif
endmenu
```

## src/tal_system/Kconfig
```kconfig
# Ktuyaconf
menu "configure system parameter"
	config STACK_SIZE_TIMERQ
		int "STACK_SIZE_TIMERQ: set stack size for sw timer queue"
		default 4096
		range 2048 16384

	config STACK_SIZE_WORK_QUEUE
		int "STACK_SIZE_WORK_QUEUE: set stack size for work queue"
		default 5120
		range 2048 16384

	config MAX_NODE_NUM_WORK_QUEUE
		int "MAX_NODE_NUM_WORK_QUEUE: set max node in work queue"
		default 100
		range 10 1000

	config STACK_SIZE_MSG_QUEUE
		int "STACK_SIZE_MSG_QUEUE: set stack size for msg queue"
		default 4096
		range 2048 16384

	config MAX_NODE_NUM_MSG_QUEUE
		int "MAX_NODE_NUM_MSG_QUEUE: set max node in msg queue"
		default 100
		range 10 1000
endmenu
```

## src/tuya_ai_basic/Kconfig
```kconfig
menu "AI Protocol Config"
    config AI_MAX_FRAGMENT_LENGTH
        int "AI_MAX_FRAGMENT_LENGTH: max fragment length"
        range 4096 512000
        default 8192

    config ENABLE_AI_PROTO_DEBUG
        bool "ENABLE_AI_PROTO_DEBUG: enable ai protocol debug"
        default n

    config AI_BIZ_TASK_DELAY
        int "AI_BIZ_TASK_DELAY: biz send task delay,unit(ms)"
        range 1 10000
        default 10

    config AI_SESSION_MAX_NUM
        int "AI_SESSION_MAX_NUM: ai session max num"
        range 3 15
        default 6

    config AI_MAX_SESSION_ID_NUM
        int "AI_MAX_SESSION_ID_NUM: ai max session id num"
        range 5 10
        default 5

    config AI_MAX_ATTR_NUM
        int "AI_MAX_ATTR_NUM: ai attribute max num"
        range 5 20
        default 10

    config AI_PACKET_SECURITY_LEVEL
        int "AI_PACKET_SECURITY_LEVEL: ai packet security level"
        range 2 4
        default 4

    config AI_CLIENT_STACK_SIZE
        int "AI_CLIENT_STACK_SIZE: ai client task size"
        range 2048 16384
        default 4096

    config AI_READ_SOCKET_BUF_SIZE
        int "AI_READ_SOCKET_BUF_SIZE: ai server read socket size"
        default 0

    config AI_WRITE_SOCKET_BUF_SIZE
        int "AI_WRITE_SOCKET_BUF_SIZE: ai server write socket size"
        default 0
endmenu
```

## src/tuya_ai_service/svc_ai_agent/Kconfig
```kconfig
menu "AI Agent Config"
	config AI_INPUT_STACK_SIZE
		int "AI_INPUT_STACK_SIZE: input stack size"
        default 4608
    config AI_INPUT_RINGBUF_SIZE
        int "AI_INPUT_RING_BUF_SIZE: input ringbuf size"
        default 65536
    config AI_INPUT_BUF_SIZE
        int "AI_INPUT_BUF_SIZE: input buf size"
        range 1024 20480
        default 6144
	config AI_OUTPUT_STACK_SIZE
		int "AI_OUTPUT_STACK_SIZE: output stack size"
        default 4096
	config AI_OUTPUT_RINGBUF_SIZE
        int "AI_OUTPUT_RINGBUF_SIZE: output ringbuf size"
        default 65536
    config AI_OUTPUT_BUF_SIZE
        int "AI_OUTPUT_BUF_SIZE: output buf size"
        range 0 20480
        default 5120
endmenu
```

## src/tuya_ai_service/svc_ai_basic/Kconfig
```kconfig
menu "AI Protocol Config"
    config ENABLE_AI_MONITOR
        bool "ENABLE_AI_MONITOR: enable ai debug monitor service"
        default y

    config AI_MAX_FRAGMENT_LENGTH
        int "AI_MAX_FRAGMENT_LENGTH: max fragment length"
        range 1024 512000
        default 10240

    config ENABLE_AI_PROTO_DEBUG
        bool "ENABLE_AI_PROTO_DEBUG: enable ai protocol debug"
        default n

    config AI_BIZ_TASK_DELAY
        int "AI_BIZ_TASK_DELAY: biz send task delay,unit(ms)"
        range 1 10000
        default 10

    config AI_SESSION_MAX_NUM
        int "AI_SESSION_MAX_NUM: ai session max num"
        range 1 5
        default 2

    config AI_BIZ_MAX_NUM
        int "AI_BIZ_MAX_NUM: ai max session id num"
        range 5 10
        default 5

	config AI_MAX_ATTR_NUM
        int "AI_MAX_ATTR_NUM: ai attribute max num"
        range 5 20
        default 10

    config AI_PING_TIMEOUT
        int "AI_PING_TIMEOUT: ai ping timeout,unit(s)"
        range 3 20
        default 6

    config AI_HEARTBEAT_INTERVAL
        int "AI_HEARTBEAT_INTERVAL: ai ping heartbeat interval,unit(s)"
        default 120

    config AI_PACKET_SECURITY_LEVEL
        int "AI_PACKET_SECURITY_LEVEL: ai packet security level"
        range 2 4
        default 4

	config AI_CLIENT_STACK_SIZE
        int "AI_CLIENT_STACK_SIZE: ai client task size"
        range 2048 16384
        default 4096

	config AI_READ_SOCKET_BUF_SIZE
        int "AI_READ_SOCKET_BUF_SIZE: ai server read socket size"
        default 0

	config AI_WRITE_SOCKET_BUF_SIZE
        int "AI_WRITE_SOCKET_BUF_SIZE: ai server write socket size"
        default 8192

    config AI_DL_IMAGE_UNIT_SIZE
        int "AI_DL_IMAGE_UNIT_SIZE: download image unit size"
        range 1024 40960
        default 4096

    config AI_HEAP_IN_PSRAM
        bool "AI_HEAP_IN_PSRAM: use psram for heap"
        default n

    config AI_STACK_IN_PSRAM
        bool "AI_STACK_IN_PSRAM: use psram for stack"
        default n

    config AI_SEND_PKT_TIMEOUT
        int "AI_SEND_PKT_TIMEOUT: ai send packet timeout, unit(s)"
        range 1 10
        default 6

    config AI_VERSION
	int "AI_VERSION: ai version"
	range 1 2
	default 1
endmenu
```

## src/tuya_ai_service/svc_ai_codec/Kconfig
```kconfig
menuconfig ENABLE_TUYA_CODEC
    bool "enable tuya codec"
    default y
    if (ENABLE_TUYA_CODEC)
        config ENABLE_TUYA_CODEC_OPUS
            bool "enable opus codec"
            default n
        config ENABLE_TUYA_CODEC_OPUS_IPC
            bool "enable opus codec through ipc"
            depends on ENABLE_TUYA_CODEC_OPUS
            default y
        config ENABLE_TUYA_CODEC_SPEEX
            bool "enable speex codec"
            default n
        config ENABLE_TUYA_CODEC_SPEEX_IPC
            bool "enable speex codec through ipc"
            depends on ENABLE_TUYA_CODEC_SPEEX
            default n
    endif
```

## src/tuya_audio_service/speex/Kconfig
```kconfig
menuconfig ENABLE_BUILD_SPEEX
    bool "ENABLE_BUILD_SPEEX: enable build speex-1.2.0"
    default n
	help
	  Speex is an Open Source/Free Software patent-free
	  audio compression format designed for speech.
	  It can be used for Voice over IP

	  http://www.speex.org/
```

## src/tuya_service/tal_cli/Kconfig
```kconfig
# Kconfig - CLI command group configuration
menuconfig ENABLE_SERIAL_CLI_CMD
    bool "Enable serial CLI commands"
    default n
    help
      Enable the serial CLI commands.

    config SERIAL_CLI_STACK_SIZE
      int "Serial CLI stack size"
      default 3072
      help
        Set the stack size for the serial CLI thread

    if (ENABLE_SERIAL_CLI_CMD)

        config CLI_CMD_SYS
            bool "Enable system commands (sys_*)"
            default y
            help
              Enable the sys_* command group

        config CLI_CMD_FS
            bool "Enable filesystem commands (fs_*)"
            default y
            help
              Enable the fs_* command group

        config CLI_CMD_KV
            bool "Enable KV storage commands (kv_*)"
            default y
            help
              Enable the kv_* command group
    endif # ENABLE_SERIAL_CLI_CMD
```

## tools/app_template/arduino/Kconfig
```kconfig
choice
    prompt "Choice Arduino Board"
    default ENABLE_ARDUINO_T2

    config ENABLE_ARDUINO_T2
        bool "ENABLE_ARDUINO_T2"

    config ENABLE_ARDUINO_T3
        bool "ENABLE_ARDUINO_T3"

    config ENABLE_ARDUINO_T5
        bool "ENABLE_ARDUINO_T5"
endchoice

if (ENABLE_ARDUINO_T2)
    config ARDUINO_BOARD
    string
    default "ARDUINO_T2"
endif

if (ENABLE_ARDUINO_T3)
    config ARDUINO_BOARD
    string
    default "ARDUINO_T3"
endif

if (ENABLE_ARDUINO_T5)
    config ARDUINO_BOARD
    string
    default "ARDUINO_T5"
endif
```

## tools/board_template/Kconfig
```kconfig
config CHIP_CHOICE
    string
    default "<platform-name>"

config BOARD_CHOICE
    string
    default "<board-name>"

config BOARD_CONFIG
    bool
    default y
```
