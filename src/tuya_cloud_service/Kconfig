## src/tuya_cloud_service/Kconfig
```kconfig
menu "configure tuya cloud service"

    config TUYA_SECURITY_LEVEL
        int
        range 0 3
        default 1

        ---help---
                0       /* security level 0,Applies to: Resource-constrained devices;Feature: Can only access Tuya Cloud */
                1       /* security level 1,Applies to: Resource-constrained devices;Feature: One-way authentication */
                2       /* security level 2,Applies to: Resource-rich equipment;Feature: Two-way authentication */
                3       /* security level 3,Applies to: Resource-rich equipment;Feature: Two-way authentication,Devices use security chips to protect sensitive information */


    config ENABLE_DEVICE_TIMER
        bool "ENABLE_DEVICE_TIMER: enable tuya device timer(cloud scheduled task) function"
        default y

        ---help---
                Device timer module: sync timer tasks from cloud(mqtt protocol 22),
                persist them into kv, and execute the dps action when a timer fires.
                Disable it to trim the code size if the device does not need cloud timers.

    menuconfig  ENABLE_CELLULAR
        bool "ENABLE_CELLULAR: enable cellular (4G/Cat.1) network support"
        default n

        ---help---
                Cellular connection managed through netmgr, on its own or beside
                wifi/wired. Boards carrying a modem select this; it has no effect on
                a platform without a cellular TKL implementation.

        if (ENABLE_CELLULAR)
            config CELLULAR_APN
                string "CELLULAR_APN: access point name, empty lets the network choose"
                default ""

                ---help---
                        Sent as AT+CGDCONT=1,"ipv4v6","<APN>" before dialling. Leave
                        empty for consumer SIMs, where the network selects a default
                        bearer. IoT and private-network SIMs usually require a
                        specific name and cannot attach without it.
        endif

    menuconfig  ENABLE_NETMGR_PROBE
        bool "ENABLE_NETMGR_PROBE: netmgr verifies that the active link reaches the cloud"
        default n

        ---help---
                WHAT OFF MEANS, and off is the shipping default. netmgr routes
                over the eligible link with the highest priority, registration
                order breaking ties, and "eligible" means the driver reports an
                association and an address. Nothing observes whether packets
                actually arrive, so no link is ever demoted for being
                unreachable and NETMGR_LINK_STATE_DEGRADED is not reachable at
                all. Every policy timing is zero, so netmgr never arms its
                shared deadline timer.

                WHAT ON ADDS: the passive reachability probe described in
                src/tuya_cloud_service/netmgr/netmgr_probe.h. It emits NO
                traffic of its own and costs no radio time - it translates the
                EVENT_MQTT_CONNECTED / EVENT_MQTT_DISCONNECTED the device
                already publishes into good and bad verdicts, and synthesises a
                bad one when a link has been active and unverified for two
                minutes. A link with evidence against it ranks below any
                eligible link with none, so the route moves. This switch also
                decides whether netmgr_probe.c is compiled: with it off, the
                backend is not in the image at all.

                TURN IT ON for a board with more than one link - wifi plus
                cellular, or wifi plus wired. The case it exists to fix is a
                device that joins an AP whose WAN is down. Without the probe
                that link is UP by every measure netmgr can see, so the device
                pins itself to it permanently and the second bearer never
                carries a byte. With the probe on, the device demotes the dead
                link and moves.

                LEAVE IT OFF on a single-link board. The ranking has one
                candidate, so a verdict against it cannot change the outcome;
                all that is left is the flash it costs and a code path that can
                do nothing useful. Off also reproduces the behaviour every
                product in this tree shipped before the probe existed, which is
                why it is the default rather than merely an option.

        if (ENABLE_NETMGR_PROBE)
            config NETMGR_PROBE_DEMOTE
                bool "NETMGR_PROBE_DEMOTE: a bad verdict may actually move the route"
                default y

                ---help---
                        y: a link netmgr has evidence against ranks below every
                        eligible link it has no evidence against, so the route
                        moves. This is the behaviour ENABLE_NETMGR_PROBE exists
                        to provide, which is why it follows it by default.

                        n: verdicts are still accumulated and still printed by
                        a bare `netmgr` on the serial CLI, and still readable
                        through netmgr_probe_stat_get(), but they do not order
                        the candidates and the route never moves because of one.
                        Ship a release this way first if you want field evidence
                        that the probe judges your fleet correctly before you
                        let it act - it is the only way to collect that evidence
                        without changing behaviour.

            config NETMGR_POLICY_MIN_DWELL_MS
                int "NETMGR_POLICY_MIN_DWELL_MS: hold a link this long before switching again, ms"
                range 0 3600000
                default 0

                ---help---
                        A MULTI-LINK BOARD SHOULD SET THIS. 0 is netmgr's
                        historical timing, a switch the instant the ranking
                        changes, and at 0 a wifi+4G board whose AP has lost its
                        WAN will oscillate. The mechanism is inherent to passive
                        probing rather than a defect:

                          1. wifi is demoted - two minutes active with no
                             verdict - and the route moves to cellular. Correct,
                             and the whole point of the probe;
                          2. netmgr promotes wifi back 30 s later. It has to: a
                             passive probe can only ever judge the ACTIVE link,
                             so using wifi again is the only way to find out
                             whether it recovered;
                          3. wifi's higher priority wins and the route moves
                             back;
                          4. two minutes later, step 1 again.

                        Every swing tears down and re-establishes the MQTT
                        session twice, because a link-type change makes tuya_iot
                        reconnect. The revalidation back-off - 30, 60, 120, 300
                        then 600 s - damps the period, so it settles at about
                        one cycle every twelve minutes and stays there. Bounded,
                        but visible in the logs and in the cloud's session
                        count.

                        This value damps the fast early end of that sequence. It
                        HOLDS a switch until the dwell expires and never
                        prevents one, and it is abandoned the moment the active
                        link stops being eligible, so it cannot strand the
                        device on a dead link. 30000 to 120000 is the useful
                        range; far below the two-minute verify timeout there is
                        little left for it to damp.

                        Offered only when the probe is on, because with the
                        probe off nothing demotes a link and there is no
                        oscillation to damp. A board that wants dwell for some
                        other reason sets netmgr_policy_t.min_dwell_ms through
                        netmgr_policy_set().
        endif

    menuconfig  ENABLE_BT_SERVICE
        bool "ENABLE_BT_SERVICE: enable tuya bt iot function"
        default n

        if (ENABLE_BT_SERVICE)
            config ENABLE_BT_NETCFG
                bool "ENABLE_BT_NETCFG: enable tuya Bluetooth netconfig"
                default y

            config ENABLE_BT_CTRL
                bool "ENABLE_BT_CTRL: enable tuya Bluetooth control"
                default y

            config BT_ADV_INTERVAL_MIN
                int "BT_ADV_INTERVAL_MIN: tuya Bluetooth min adv interval,bet:ms"
                range 10 2000
                default 30

            config BT_ADV_INTERVAL_MAX
                int "BT_ADV_INTERVAL_MAX: tuya Bluetooth max adv interval,bet:ms"
                range 10 2000
                default 60
            
            config BT_REMOTE_CTRL_SCAN_INTERVAL
                int "BT_REMOTE_CTRL_SCAN_INTERVAL: tuya Bluetooth remote control scan interval,bet:ms"
                range 10 2000
                default 30

            config BT_REMOTE_CTRL_SCAN_WINDOWS
                int "BT_REMOTE_CTRL_SCAN_WINDOWS: tuya Bluetooth remote control scan windows,bet:ms"
                range 10 2000
                default 10

            menuconfig ENABLE_NIMBLE
                bool "ENABLE_NIMBLE: enable nimble stack instead of ble stack in board"
                default y
                if (ENABLE_NIMBLE) 
                    config TUYA_HS_BLE_HOST_TASK_PRIORITY
                    int "TUYA_HS_BLE_HOST_TASK_PRIORITY config bt host task proi"
                    range 0 100
                    default 9
                    config TUYA_HS_BLE_HOST_STACK_SIZE
                    int "TUYA_HS_BLE_HOST_STACK_SIZE config bt host task size"
                    range 0 10000
                    default 5120
                endif
        endif
endmenu
    
```

## src/tuya_p2p/Kconfig
```kconfig
# Ktuyaconf
menuconfig ENABLE_TUYA_P2P
	bool "Enable Tuya P2P"
	default n
	help
		Enable Tuya P2P (ICE/RTP/streaming) and optional local media helpers.

	if ENABLE_TUYA_P2P
		rsource "local_store/Kconfig"
		rsource "svc_ring_buffer/Kconfig"
	endif # ENABLE_TUYA_P2P
```

## src/tuya_p2p/ipc_cloud_store/Kconfig
```kconfig
# Ktuyaconf
menuconfig ENABLE_IPC_CLOUD_STORE
	bool "ENABLE_IPC_CLOUD_STORE: IPC continuous cloud recording (skeleton)"
	default n
	depends on ENABLE_TUYA_P2P
	help
	  Skeleton for OS-aligned IPC cloud storage (order/OSS/slice).
	  Upload path is not fully ported yet; APIs are stable for app wiring.
```

## src/tuya_p2p/local_store/Kconfig
```kconfig
# Ktuyaconf
menuconfig ENABLE_LOCAL_STORE
	bool "ENABLE_LOCAL_STORE: Enable local media storage"
	default n
	depends on ENABLE_TUYA_P2P
	help
	  Segment recorder, day index and segment reader for media files on the
	  filesystem (host directory on LINUX, SD/flash via tkl_fs elsewhere).

	if ENABLE_LOCAL_STORE
		config LOCAL_STORE_ROOT
			string "LOCAL_STORE_ROOT: storage root directory"
			default "/sdcard/media" if PLATFORM_T5
			default "./media"
			help
			  T5 boards store under the SD mount. LINUX uses a host relative path.

		config LOCAL_STORE_REC_SUBDIR
			string "LOCAL_STORE_REC_SUBDIR: recording subdir under root"
			default "rec"
			help
			  Recording files are placed under ROOT/REC_SUBDIR/YYYY-MM-DD/.

		config LOCAL_STORE_PATH_MAX
			int "LOCAL_STORE_PATH_MAX: max path buffer length"
			default 256
			range 128 1024

		config LOCAL_STORE_STAGE_KB
			int "LOCAL_STORE_STAGE_KB: recorder ring between encoder and writer, KB"
			default 512
			range 64 4096
			help
			  Frames wait here while the writer is blocked on the card. Size it
			  for the longest write stall you expect at the encoder bitrate;
			  1 Mbps for 2 s is 256 KB. Allocated from PSRAM when ENABLE_EXT_RAM.

		config LOCAL_STORE_WRITE_KB
			int "LOCAL_STORE_WRITE_KB: bytes gathered before one fwrite, KB"
			default 64
			range 8 512

		config LOCAL_STORE_SYNC_MS
			int "LOCAL_STORE_SYNC_MS: fsync and index flush period while recording, ms"
			default 3000
			range 500 60000

		config LOCAL_STORE_KEEP_DAYS
			int "LOCAL_STORE_KEEP_DAYS: delete day directories older than this (0 = never)"
			default 0
			range 0 3650
			help
			  Also used when a write fails for lack of space: the oldest day
			  other than today is removed and the write retried.

		config LOCAL_STORE_READ_KB
			int "LOCAL_STORE_READ_KB: reader buffer, KB (must hold the largest frame)"
			default 320
			range 64 2048
	endif # ENABLE_LOCAL_STORE
```

## src/tuya_p2p/svc_ring_buffer/Kconfig
```kconfig
# Ktuyaconf
menuconfig ENABLE_IPC_RING_BUFFER
	bool "ENABLE_IPC_RING_BUFFER: IPC AV ring buffer (push model)"
	default y
	depends on ENABLE_TUYA_P2P
	help
	  Frame ring used by the live/playback P2P send path.
```

## src/tuya_service/tuya_pm/Kconfig
```kconfig
config ENABLE_TUYA_PM
    bool "Enable power-level manager (tuya_pm)"
    default n
    select ENABLE_WIFI_ULTRA_LOWPOWER if ENABLE_WIFI
    help
      Device power-level manager: a policy/arbitration layer that maps discrete
      power levels (ACTIVE/STANDBY/DORMANT/DEEPSLEEP) onto lpmgr / tal_cpu
      wakelock / tdl_power / tkl_wakeup. Products declare a policy and register
      hold-locks / consumers; the manager arbitrates the effective level and
      decays on idle.

      On WiFi platforms this pulls in the WiFi ULP framework (lpmgr) as the deep
      low-power backend, so the online levels can actually reach uA.
```
